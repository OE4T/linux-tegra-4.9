## Documentation/devicetree/bindings/platform/tegra/tegra-ape-ivc.txt
```
NVIDIA Tegra APE aux CPU, with communication via the "IVC" IPC protocol.

APE is an aux CPU which talks to CCPLEX over IVC.

Its assumed that the APE FW implements IVC, and uses HSP IRQs as part of IVC.
Its also assumed that the APE FW expects AST regions 0/1/2 are already set up
for the APE to access FW in DRAM, SYSRAM if applicable, and the IVC memory.

== APE top-level node ==

The APE core is represented by the top-level node including direct HW resources
such as clocks, resets etc.

Required properties:
- compatible: should be "nvidia,tegra186-ape-ivc" for T18x.
- reg: Address entries (APE BASE)
  Formatted as per standard rules for this property.
- nvidia,ast: APE AST0 and APE AST1 phandles
  For details refer: ../tegra-ast.txt
- #address-cells: Number of address cells in subnodes (ivc-channels).
  Should be set to <1>.
- #size-cells: Number of size cells in subnodes (ivc-channels).
  Should be set to <1>.
- clocks: Should contain an entry for each entry in clock-names.
  See ../clock/clock-bindings.txt for details.
- clock-names: Names of the clocks required by APE.
  Must include following entries:
  - ahub
  - apb2ape
  - ape
  - adsp
  - adspneon
- resets: Should contain an entry for each entry in reset-names.
  See ../reset/reset.txt for details.
- reset-names: Names of the resets required for APE.
  Must include following entries:
  - adspdbg
  - adspintf
  - adspneon
  - adspperiph
  - adspscu
  - adspwdt
  - ape
  - adsp

== APE sub nodes ==

* ivc-channels

Contains a sub-node for each IVC channel implemented by the APE.
For IVC channel details, please refer: ./tegra-ivc-channel.txt

* hsp

Describes the hardware synchronization primitive(s) used between CCPLEX
and SCE to signal incoming IVC messages or IVC write room.

Required property:
- compatible: Should match with the device driver implementing the
    cross-processor synchronization primitive.

If the HSP doorbell is used for IVC notifications:

- compatible: "nvidia,tegra186-hsp-doorbell"

- nvidia,hsp-doorbell: <HSP-phandle HSP-ID HSP-DB>
  * HSP is a set of HW synchronization primitives used in Tegra to allow
    multiple processors to share resources and communicate together.
  * HSP-ID is NVIDIA Tegra HSP unique source ID for SCE, used in IPC.
  * HSP-DB is NVIDIA Tegra HSP unique doorbell number allotted to SCE.
    A HSP doorbell allows a set of source agents in Tegra to request the
    attention of specified target agent. In general the agents are processors
    and doorbell used as part of an IPC protocol.
  * For more HSP details, refer: ./tegra-hsp.txt.

If the HSP shared mailbox is used for IVC notifications:

- nvidia,hsp-shared-mailbox: <HSP-phandle MBOX-NUMBER HSP-phandle MBOX-NUMBER...>
  * HSP is a set of HW synchronization primitives used in Tegra to allow
    multiple processors to share resources and communicate together.
  * MBOX-NUMBER is number of shared mailbox pair
  * For more HSP details, refer: ../tegra-hsp.txt.

- nvidia,hsp-shared-mailbox-names:
  Must include following entry:
  - ivc-pair

If the HSP shared mailbox is used for boot synchronization:

- nvidia,hsp-shared-mailbox: <HSP-phandle MBOX-NUMBER...>
- nvidia,hsp-shared-mailbox-names:
  Must include following entry:
  - cmd-pair

== Possible example ==

tegra_ape: rtcpu@2993000 {
	compatible = "nvidia,tegra186-ape-ivc";
	reg = <0x0 0x2993000 0x0 0x10000>;
	nvidia,ast = <&ape_ast0>, <&ape_ast1>;
	clocks =
		<&tegra_car TEGRA186_CLK_AHUB>,
		<&tegra_car TEGRA186_CLK_APB2APE>,
		<&tegra_car TEGRA186_CLK_APE>,
		<&tegra_car TEGRA186_CLK_ADSP>,
		<&tegra_car TEGRA186_CLK_ADSPNEON>;
	clock-names =
		"ahub",
		"apb2ape",
		"ape",
		"adsp",
		"adspneon";
	resets =
		<&tegra_car TEGRA186_RESET_ADSPDBG>,
		<&tegra_car TEGRA186_RESET_ADSPINTF>,
		<&tegra_car TEGRA186_RESET_ADSPNEON>,
		<&tegra_car TEGRA186_RESET_ADSPPERIPH>,
		<&tegra_car TEGRA186_RESET_ADSPSCU>,
		<&tegra_car TEGRA186_RESET_ADSPWDT>,
		<&tegra_car TEGRA186_RESET_APE>,
		<&tegra_car TEGRA186_RESET_ADSP>;
	reset-names =
		"adspdbg",
		"adspintf",
		"adspneon",
		"adspperiph",
		"adspscu",
		"adspwdt",
		"ape",
		"adsp";

	#address-cells = <1>;
	#size-cells = <1>;
	ivc-channels@0 {
		#address-cells = <1>;
		#size-cells = <0>;
		reg = <0x90000000 0x10000>;
		ivc-channel@0 {
			compatible = "nvidia,tegra186-camera-ivc-protocol-echo";
			reg = <0x0000>, <0x0480>;
			reg-names = "rx", "tx";
			nvidia,frame-size = <64>;
			nvidia,frame-count = <16>;
		};
	};
	hsp {
		compatible = "nvidia,tegra186-hsp-mailbox";
		nvidia,hsp-shared-mailbox = <&ape_hsp 1>, <&ape_hsp 7>;
		nvidia,hsp-shared-mailbox-names = "ivc-pair", "cmd-pair";
	};
};
```

## Documentation/devicetree/bindings/platform/tegra/tegra-ast.txt
```
* NVIDIA Tegra Address Space Translation (AST) bindings

Tegra AST unit converts any auxiliary CPUs' local AXI PA space
(it is not the CCPLEX PA space) to either Physical or virtual MC
Address space. i.e. its local slave address to either PA or
if SMMU enabled then to IOVA.

== AST Device Nodes ==

Required properties:

- compatible: should be "nvidia,tegra186-ast" for T18x.

- reg: base address and length of the AST aperture

Possible example:

some_device_ast0: ast@b040000 {
	compatible = "nvidia,tegra186-ast";
	reg = <0 0x0b040000 0 0x10000>;
};

some_device_ast1: ast@b050000 {
	compatible = "nvidia,tegra186-ast";
	reg = <0 0x0b050000 0 0x10000>;

};

== Clients ==

Clients that use an AST must define a property that contains
the phandle of the AST device.
The name of this property is defined by the client's binding.

A possible example is:

some_device {
	nvidia,ast0 = <&some_device_ast0>;
	nvidia,ast1 = <&some_device_ast1>;
};

Or only single property can contain mutliple AST phandles, like:

some_device {
	nvidia,ast = <&some_device_ast0>, <&some_device_ast1>;
};
```

## Documentation/devicetree/bindings/platform/tegra/tegra-eqos.txt
```
Device tree binding for NVIDIA Tegra186 Ethernet QOS Controller
=================================================================

The Tegra186 EQOS (Ethernet QOS) device is an Ethernet controller which
supports Quality of Service features.


Required properties:
- compatible: should be "synopsys,dwc_eth_qos"
- reg: Physical base address and length of registers.
- interrupts: An array of tuples specifying IRQ number for each tx/rx queue.
- nvidia,csr_clock_speed: Specifies number of clocks in a microsecond.
	Controls reference time for LPI timers when EEE is enabled.
- nvidia,local-mac-address: Assigned MAC addressed.  This is
	populated by BL.
- clocks: Specifies the needed clocks.
- clock-names: Specifies the names of the needed clocks.
- resets: Specifies the reset line.
- reset-names: Specifies the name of the reset line.
- nvidia,ptp_ref_clock_speed: Specified in microseconds.
- nvidia,rxq_enable_ctrl: An array where each entry specifies operating
	mode for rx queue.
- nvidia,phy-reset-gpio: Specifies gpio pin for resetting PHY.
- nvidia,phy-intr-gpio: Specifies gpio pin for PHY interrupts.

Optional properties:
- nvidia,use_tagged_ptp: If specified, enables tagged PTP.
- nvidia,ptp_dma_ch: Specifies channel to route PTP packets.
	Channel 0 is default.
- nvidia,intr_mode: Specifies if only one IRQ is enabled or one for each
	channel.  Default is one IRQ.
- nvidia,chan_mode: Specifies operating mode for each channel's irq handler.
	Only applicable if intr_mode is "1". Default is NAPI.
- nvidia,chan_napi_quota: Specifies number of tx/rx completions to process
	when napi handler is called.  Default is "64".
- nvidia,pause_frames: Used to disable/enable PAUSE frames support.
	Default is enabled.
```

## Documentation/devicetree/bindings/platform/tegra/tegra-hsp.txt
```
* NVIDIA Tegra Hardware Synchronization Primitives (HSP) bindings

Tegra HSP unit is designed to support synchronization among processors on the
SOC for various tasks where shared resources need to be accessed exclusively
or inter-processor communications support.

Required properties:

- compatible: should be "nvidia,tegra186-hsp"

- reg: base address and length of the HSP aperture

- interrupts: CPU's doorbell interrupt

- nvidia,num-SM: number of shared mailboxes

- nvidia,num-AS: number of arbitrated semaphores

- nvidia,num-SS: number of shared semaphores

- nvidia,num-DB: number of doorbells

- nvidia,num-SI: number of shared interrupts

Symbolic doorbell constants are defined in:
  <dt-bindings/platform/t186/tegra-hsp.h>
```

## Documentation/devicetree/bindings/platform/tegra/tegra-ivc-channel.txt
```
NVIDIA Tegra IVC channel bindings

Each IVC channel represents the unique communication protocol defined between
CCPLEX and remote CPU.

IVC IPC memory layout assumptions:
Its assumed that this memory will be divided into two halves,
with this CPU writing to the first half and the remote CPU
writing to the second half.

Within each "half" of the IPC memory:

IPC memory portion written by A, at "chan-offset", includes:
write header for A->B transfer
read header for B->A transfer
data for A->B transfer.

IPC memory portion written by B, at "chan-offset", includes:
write header for B->A transfer
read header for A->B transfer
data for B->A transfer.

== IVC channel top-level node ==

List of IVC channels implemented by remote core to talk to CCPLEX.
The node name must be "ivc-channels[@<unit-address>]".

Required properties:
- #address-cells: Number of address cells in each subnode.
  * Must be set to <1>.
- #size-cells: Number of size cells in each subnode.
  * Must be set ot <0>.
- reg: Must contain an arbitrary unique ID for the channel list.

== IVC channel sub nodes ==

Each IVC channel implemented by the remote core must be represented as a
separate child node within the IVC channel top-level node.

Required properties:
- compatible: Should represent the protocol to be used on this IVC channel.
  See other binding documents in this directory for potential values.
  For e.g.:
  "nvidia,tegra186-ivc-protocol-echo" for ivc echo test channel.
- nvidia,frame-size: Size of the data frame, should be word-aligned.
- nvidia,chan-offset: Absolute offset from ivc base addr.
- nvidia,frame-count: Number of frames in rx/tx buffer.
- reg: Must contain an arbitrary unique ID for the channel.

Possible example:
ivc-channels@0 {
	#address-cells = <1>;
	#size-cells = <0>;
	reg = <0>;
	ivc-channel@0 {
		compatible = "nvidia,tegra186-ivc-protocol-echo";
		reg = <0>;
		nvidia,frame-size = <64>;
		nvidia,chan-offset = <0x0>;
		nvidia,frame-count = <16>;
	};
}
```

## Documentation/devicetree/bindings/platform/tegra/tegra-ivc-client.txt
```
* NVIDIA Tegra IVC client driver

== IVCC device ==
Each IVCC device represents a remote processor that talks to CPU via IVC.

Required properties:
- compatible: The driver is compatible with
  "nvidia,tegra186-ivcc"

- nvidia,notifications: <HSP-phandle HSP-id HSP-doorbell>
  both HSP-id and -doorbell can be referenced by including:
    <dt-bindings/platform/t186/tegra-hsp.h>

== IVCC channel ==
Each channel is a distinct functionality that needs IPC service.
It's represented as a child node under the IVCC device node.

Required properties:

- reg: Two address entries (CPU's POV)
  * Base address and length of the write buffer
  * Base address and length of the read buffer

- nvidia,frame-size: size of the data frame, should be in range
  [4, buffer-size] and word-aligned.

== Shared memory carveout ==
All IVC headers and data channels are placed in a pre-defined known area
which is carved out away from kernel usage. This is currently done by
the /memreserve/ feature. As such, the IVC and channel reg properties must
lie within this pre-defined area.

Example:

/memreserve/ 0xa0030000 0x1000;
/memreserve/ 0xa0040000 0x1000;

ivcc@0xa0030000 {
	compatible = "nvidia,tegra186-ivcc";
	nvidia,notifications = <&hsp_top
		TEGRA_HSP_PROC_FOO
		TEGRA_HSP_DB_FOO>;
	#address-cells = <2>;
	#size-cells = <2>;
	ranges;
	ivcc-chan1: ivcc-chan@0xa0030100 {
		reg = <0 0xa0030100 0 0x400>,
		      <0 0xa0040100 0 0x400>;
		nvidia,frame-size = <64>;
	};

	ivcc-chan2: ivcc-chan@0xa0030500 {
		reg = <0 0xa0030500 0 0x400>,
		      <0 0xa0040500 0 0x400>;
		nvidia,frame-size = <64>;
	};
};

== Clients ==
Clients that use IVC channels must define below property in its node:

- nvidia,ivcc-channels: a list of channel phandles pointing to the
  nodes representing the desired IVC channels.

Example:

    some_device {
	nvidia,ivcc-channels = <&ivcc-chan1>, <&ivcc-chan2>;
    };
```

## Documentation/devicetree/bindings/platform/tegra/tegra-mce.txt
```
* Nvidia Tegra Micro Coded Engine (MCE)

Required properties:
- compatible: The driver is compatible with
  "nvidia,tegra186-mce"

- reg: base address and size of MCE aperture

Example:

mce {
	compatible = "nvidia,tegra186-mce";
	reg = <0x0 0x0e000000 0x0 0x60000>;
};
```
