## Documentation/devicetree/bindings/platform/tegra/tegra-sce-ivc.txt
```
NVIDIA Tegra SCE aux CPU, with communication via the "IVC" IPC protocol.

SCE is an aux CPU which talks to CCPLEX over IVC.

The SCE FW implements IVC, and uses HSP IRQs as part of IVC.  The
SCE FW expects AST regions 0/1/2 are already set up for the SCE to
access FW in DRAM, SYSRAM if applicable, and the IVC memory.

== SCE top-level node ==

The SCE core is represented by the top-level node including direct HW resources
such as clocks, resets etc.

Required properties:
- compatible: Should be "nvidia,tegra186-sce-ivc" for T18x.
- reg: Address entries (SCE BASE, SCE CFG BASE, SCE_EVP, SCEPM)
  Formatted as per standard rules for this property.
- nvidia,ast: SCE AST0 and AST1 phandles
  For details refer: ../tegra-ast.txt
- clock-names: Names of the clocks required by SCE.
  Must include following entry:
  - sce-apb
- clocks: Should contain an entry for each entry in clock-names.
  See ../clock/clock-bindings.txt for details.
- reset-names: Names of the resets required for SCE.
  Must include following entries:
  - sce-apb
  - sce-nsysporeset
  - sce-nreset
  - sce-dbgresetn
  - sce-presetdbgn
  - sce-actmon
  - sce-pm
  - sce-dma
  - sce-hsp
  - tsctnsce
  - sce-tke
  - sce-gte
  - sce-cfg
- resets: Should contain an entry for each entry in reset-names.
  See ../reset/reset.txt for details.
- #address-cells: Number of address cells in each subnode (ivc-channels).
  Must be set to <1>.
- #size-cells: Number of size cells in each subnode (ivc-channels).
  Must be set to <1>.

== SCE sub nodes ==

* ast

Tegra AST unit converts any auxiliary CPUs' local AXI PA space
(not the CCPLEX PA space) to either physical or virtual MC
address space, i.e. its local slave address to either PA or
if SMMU enabled then to IOVA.

Required property:

- reg: base address and length of the AST aperture
  * Two apertures are required for SCE, so there should be two
    <address, length> pairs.

* ivc-channels

Contains a sub-node for each IVC channel implemented by the SCE.
For IVC channel details, please refer: ./tegra-ivc-channel.txt

* hsp

Describes the hardware synchronization primitive(s) used between CCPLEX
and SCE to signal incoming IVC messages or IVC write room.

Required property:
- compatible: Should match with the device driver implementing the
    cross-processor synchronization primitive.

If the HSP doorbell is used for IVC notifications:

- compatible: "nvidia,tegra186-hsp-doorbell"

- nvidia,hsp-doorbell: <HSP-phandle HSP-ID HSP-DB>
  * HSP is a set of HW synchronization primitives used in Tegra to allow
    multiple processors to share resources and communicate together.
  * HSP-ID is NVIDIA Tegra HSP unique source ID for SCE, used in IPC.
  * HSP-DB is NVIDIA Tegra HSP unique doorbell number allotted to SCE.
    A HSP doorbell allows a set of source agents in Tegra to request the
    attention of specified target agent. In general the agents are processors
    and doorbell used as part of an IPC protocol.
  * For more HSP details, refer: ./tegra-hsp.txt.

If the HSP shared mailbox is used for IVC notifications:

- nvidia,hsp-shared-mailbox: <HSP-phandle MBOX-NUMBER HSP-phandle MBOX-NUMBER...>
  * HSP is a set of HW synchronization primitives used in Tegra to allow
    multiple processors to share resources and communicate together.
  * MBOX-NUMBER is number of shared mailbox pair
  * For more HSP details, refer: ../tegra-hsp.txt.

- nvidia,hsp-shared-mailbox-names:
  Must include following entry:
  - ivc-pair

If the HSP shared mailbox is used for boot synchronization:

- nvidia,hsp-shared-mailbox: <HSP-phandle MBOX-NUMBER...>
- nvidia,hsp-shared-mailbox-names:
  Must include following entry:
  - cmd-pair

== Possible example ==

tegra_sce: rtcpu@b000000 {
	compatible = "nvidia,tegra186-sce-ivc";
	reg =	<0 0xb000000 0 0x1000>,	  /* SCE EVP (SCE_ATCM_EVP) */
		<0 0xb1f0000 0 0x40000>,  /* SCE PM */
		<0 0xb230000 0 0x10000>;  /* APS_FRSC (SCE_CFG) */
	clocks = <&tegra_car TEGRA186_CLK_SCE_APB>;
	clock-names = "sce-apb";
	resets =
		<&tegra_car TEGRA186_RESET_SCE_APB>,
		<&tegra_car TEGRA186_RESET_SCE_NSYSPORESET>,
		<&tegra_car TEGRA186_RESET_SCE_NRESET>,
		<&tegra_car TEGRA186_RESET_SCE_DBGRESETN>,
		<&tegra_car TEGRA186_RESET_SCE_PRESETDBGN>,
		<&tegra_car TEGRA186_RESET_SCE_ACTMON>,
		<&tegra_car TEGRA186_RESET_SCE_PM>,
		<&tegra_car TEGRA186_RESET_SCE_DMA>,
		<&tegra_car TEGRA186_RESET_SCE_HSP>,
		<&tegra_car TEGRA186_RESET_TSCTNSCE>,
		<&tegra_car TEGRA186_RESET_SCE_TKE>,
		<&tegra_car TEGRA186_RESET_SCE_GTE>,
		<&tegra_car TEGRA186_RESET_SCE_CFG>;
	reset-names =
		"sce-apb",
		"sce-nsysporeset",
		"sce-nreset",
		"sce-dbgresetn",
		"sce-presetdbgn",
		"sce-actmon",
		"sce-pm",
		"sce-dma",
		"sce-hsp",
		"tsctnsce",
		"sce-tke",
		"sce-gte",
		"sce-cfg";
	nvidia,ast = <&sce_ast0>, <&sce_ast1>;
	#address-cells = <1>;
	#size-cells = <1>;
	ranges;

	ast {
		reg = <0x0b040000 0x10000>, <0x0b050000 0x10000>;
	};
	ivc-channels@90000000 {
		#address-cells = <1>;
		#size-cells = <0>;
		reg = <0x90000000 0x10000>;
		ivc-channel@0 {
			compatible = "nvidia,tegra186-camera-ivc-protocol-echo";
			reg = <0x0000>, <0x8000>;
			reg-names = "rx", "tx";
			nvidia,frame-size = <64>;
			nvidia,frame-count = <16>;
		};
	};
	hsp {
		compatible = "nvidia,tegra186-hsp-mailbox";
		nvidia,hsp-shared-mailbox = <&sce_hsp 1 &sce_hsp 7>;
		nvidia,hsp-shared-mailbox-names = "ivc-pair", "cmd-pair";
	};
};
```

## Documentation/devicetree/bindings/platform/tegra/tegra_cbb.txt
```
NVIDIA Tegra19x CBB NOC driver
==================================

This document defines the device-specific binding for Tegra19x CBB NOC driver.

Control Backbone(CBB) comprises of the physical path from a master(or initiator)
to a slave’s(or target) register configuration space(Target’s Control Space).
CBB has multiple hierarchical sub-NOC's(Network-on-Chip) and stretches to
various master and slave partitions using different bridges like AXIP2P,AXI2APB.

This driver handles Error's from Control Backbone(CBB) in case of failed
transaction in bridge within CBB. For access frorm CCPLEX master, SError
will be reported. For access by other masters, issuing master will get abort
and interrupt will be reported to CCPLEX.

The driver prints relevant debug information like Error Code, Error Description,
Master, Address, AXI ID, Cache, Protection, Security Group etc on receiving
SError or interrupt due to bridge error using CBB's Error Logger registers.

Required properties:

- compatible: Should be "nvidia,tegra194-CBBNOCAXI-bridge"
- reg: Physical base address and length of registers

Example:
========
cbbnocaxi@2100000 {
                 compatible = "nvidia,tegra194-CBBNOCAXI-bridge";
                 reg = <0x0 0x02300000 0x0 0x1000>;
                 status = "okay";
};
```

## Documentation/devicetree/bindings/power/supply/isl9238_charger.txt
```
* ISL9238 battery charger devicetree bindings

Required properties:
- compatible : "isil,isl9238"
- reg: I2C slave address

Required nodes:
- regulators: There must a regulator subnode for the following purposes:
               Enabling voltage supply to vbus port(to enable otg mode)

Optional properties:
- isl,charge-current-limit-ma: to set the charging current limit in ma

- isl,max-system-voltage-mv: to set the maximum charging voltage or
			 system regualting voltage

- isl,min-system-voltage-mv: to set the minimum system voltage

- isl,input-voltage-limit-mv: to set input voltage limit

- isl,adapter-current-limit1-ma: to se the adapter current limit 1

- isl,adapter-current-limit2-ma: to se the adapter current limit 2

- isl,acprochot-threshold: assertion threshold for adapter overcurrent
			   condition.

- isl,dcprochot-threshold: assertion threshold for adapter overcurrent
			   condition.

- isl,trickle-chg-current-ma: to configure trickle charging current

- isl,current-sense-res: current_sense_reister(rs1, rs2) to configure
			 charging current limit
			 charging current depends on sense resister value

- isl,adapter-sense-res: adapter_sense_reister(rs1, rs2) to configure
			 adapter current limit
			 adapter current depends on sense resister value

- isl,otg-voltage-mv: to set OTG mode output regulation voltage

- isl,otg-current-ma: to set OTG mode curret

- isl,disable-regulation: disable input volatge regulation, by default
			  input voltage regulation enabled

- isl,enable-bat-learn-mode: enable battery learn mode, by default
			    battery learn mode disabled

- isl,disable-turbo-mode: disable turbo mode, by default
			  turbo charging mode enabled

- isl,enable-auto-charging: enable auto charging mode

- isl,enable-battery-ovp: enables Battery OV (Overvoltage) fault protection
			by default battery ov fault disabled

- isl,enable-trigger-acok: enables trigger PROCHOT# with ACOK
			by default acok trigger disabled

- isl,enable-prochot-otg-current: enables trigger PROCHOT# with OTGCURRENT
			by default otgcurrent trigger disabled

- isl,disable-smbus-timer: disable smbus timer(safety timer)
			by default smbus timer enabled
			smbus timer used to ensure the SMBus master
			is active and to prevent overcharging the battery.

- isl,enable-psys-monitor: enables system power monitor PSYS function
			by default PSYS function is disabled

vbus properties:
================
regulator-name: vbus regulator name.

Example
bc_isl9238: isl9238@9 {
	compatible = "isil,isl9238";
	reg = <0x09>;
	isl,charge-current-limit = <4096000>;
	isl,max-system-voltage = <8192000>;
	isl,min-system-voltage = <1024000>;
	isl,input-voltage-limit = <2730000>;
	isl,enable-auto-charging;

	vbus {
		regulator-name = "vbus-regulator";
	};
};
```

## Documentation/devicetree/bindings/sound/tegra-adsp.txt
```
Tegra ADSP bindings
-------------------

These are additional bindings compared to exiting ADSP bindings.

Optional properties:
- nvidia,adsp_os_secload: shall be added when boot-loader has securely loaded
	adsp firmware image into carve out memory.

Example:
	adsp {
             compatible = "nvidia,tegra210-adsp";
	     ...
	     nvidia,adsp_os_secload;
	};
```

## arch/arm64/Kconfig
```kconfig
config ARCH_TEGRA_18x_SOC_PRIVATE
	bool "Tegra 18x family SOC"
	select CPU_V8
	select ARM_GIC
	select COMMON_CLK
	select SOC_BUS
	select ARCH_REQUIRE_GPIOLIB
	select PINCTRL
	select PINCTRL_TEGRA186
	select ARCH_TEGRA_APE
	default n
	help
	  Support for NVIDIA Tegra 18x family of SoCs
```

## arch/arm64/Kconfig.nvidia
```kconfig
config ARCH_TEGRA_19x_SOC_PRIVATE
	bool "Tegra 19x family SOC"
	select PINCTRL
	select PINCTRL_TEGRA194
	default n
	help
	  Support for NVIDIA Tegra 19x family of SoCs
```
