## Documentation/devicetree/bindings/cpufreq/tegra_cpufreq_t18x.txt
```
* Device tree binding for Nvidia Tegra18x cpufreq driver for EDVD device
--------------------------------------------

This document defines the device-specific binding for the Tegra18x cpufreq
driver. It should not contain bindings for generic tegra cpufreq driver
which are common across all the tegra cpufreq platform driver.

The Tegra18x cpufreq driver adjusts CPU frequency by writing voltage and
freq hint in EDVD per core volt freq request registers. It calculates per
core cpufreq by reading per core cycle counters. Cycles are measured by
reading EDVD per core clock count registers and divided by ref clock counter.
The ressult is multiplied by ref clock.

Tegra18x cpufreq driver considers these EDVD registers as device to measure
and adjust cpu freq. There is one instance of EDVD for the Denver cluster
and one for the A57 cluster.

Required properties:
- compatible: should be "nvidia,tegra18x-cpufreq".
- reg: an array of four 64-bit unsigned integers:
       the base address and size for Denver EDVD aperture and the base
       address and size for the A57 EDVD aperture.

- status: "okay" or "disabled" to enable/disable the node.

Example:
--------
       cpufreq@e070000 {
               compatible = "nvidia,tegra18x-cpufreq";
               reg = <0x0 0x0e070000 0x0 0x1000>, /* M/Denver cluster */
                     <0x0 0x0e060000 0x0 0x1000>; /* B/ARM cluster */
               status = "disabled";
       };
```

## Documentation/devicetree/bindings/extcon/extcon-gpio-states.txt
```
EXTCON FOR GPIO-STATES

Required Properties:
 - compatible : Should be "extcon-gpio-states";

Optional Properties:
 - extcon-gpio,name: Name of extcon device.
 - gpios: List of teh gpios.
 - extcon-gpio,irq-flags: IRQ flags for GPIO.
 - extcon-gpio,debounce: Debounce time in ms.
 - extcon-gpio,wait-for-gpio-scan: Wait timeout for scanning all gpio states
	after chnage found in gpio and debounce timeof gpio is completed.
 - extcon-gpio,out-cable-names: Output cable names.
 - extcon-gpio,cable-states: GPIO states and ther corresponding output cable
	state. This is array of the data for table as
		gpio-state <-> output cable-state
extcon-gpio {
	compatible = "extcon-gpio-states";
       	gpio = <&gpio 20 0 &gpio 30 0>;
	extcon-gpio,cable-states = <0x00 0x00
				    0x01 0x01
				    0x02 0x02
				    0x03 0x4>;
	extcon-gpio,out-cable-names = "vbus", "host", "otg-y-cable";
};
```

## Documentation/devicetree/bindings/iio/ak8963c-compass.txt
```
* AKM 8963C Compass sensor

Required properties:
- compatible: must be "ak,ak89xx"
- reg: i2c address of the device. It should be 0x0C or 0x0D.

Optional propertied:
- orientation:  Orientation matrix for this device.

Example:

	ak8963c@0d {
		compatible = "ak,ak89xx";
                reg = <0x0d>;
                orientation = [ff 00 00 00 ff 00 00 00 01];
        };
```

## Documentation/devicetree/bindings/iio/bmp280-pressure.txt
```
* Bosch BMP-280 pressure sensor

Required properties:
- compatible: must be "bmp,bmpX80"
- reg: i2c address of the device. It should be 0x76 or 0x77.

Optional propertied:

Example:

	bmp280@77 {
                compatible = "bmp,bmpX80";
                reg = <0x77>;
        };
```

## Documentation/devicetree/bindings/iio/cm3218x-als.txt
```
* Capella CM3218/CM32180/CM32181 ambient light sensor

nvs_ drivers use the NVidia Sensor (NVS) framework.
See the nvs.txt documentation for NVS DT capabilities.
The nvs_cm3218 ALS sensor driver supports the CM3218, CM32180, and CM32181
devices.

Required properties:
- compatible: Device or generic name.
	      Supported device names:
	      - capella,cm3218x
	      - capella,cm3218
	      - capella,cm32180
	      - capella,cm32181
  Note: If the part is known and is populated, then it can be specified:
	Example: compatible = "capella,cm32181";
	When specifying a device this way, the driver will assume this specific
	device is populated during system boot and will not verify its
	existence.  If, however, the device is unknown or may not be populated,
	then the label, cm3218x, (Example: compatible = "capella,cm3218x";),
	must be used.  This tells the driver to find which device is used.  If
	the device is not found, the driver will unload itself.  This requires
	regulators to be setup correctly for the probe function.
- reg: i2c address of the device. It should be 0x10 or 0x48.

Optional properties:
- status: set to "ok" or "okay" for normal operation.  Set to anything else
	  to unload the driver without ever communicating with the device.
  Note: The "anything else" above is typically "disabled".
	Since the driver will unload without communicating with the device, the
	device will be left in its POR state.
	This device's POR comes up in an operational mode and will draw power.
	If it is desired to unload the driver leaving the device in a low power
	sleep state, then use the individual sensor disable mechanism below.
- light_disable: Setting this property to <1> will disable the device and
                 unload the driver.
- vdd-supply: regulator supply for the chip
  Note: This is required if the driver is to control the regulator.
- interrupt-parent:  GPIO number
- interrupts:  GPIO macro
  Note: The driver will operate in poll mode if an interrupt is not specified.

Example:
	cm3218x@48 {
		compatible = "capella,cm3218x";
		reg = <0x10>;
		vdd-supply = <&palmas_smps9>;
	};
```

## Documentation/devicetree/bindings/iio/icm20628-gyro.txt
```
* Invensense ICM-20628 Gyro/Accelerometer sensor

Required properties:
- compatible: must be "invensense,mpu6xxx"
- reg: i2c address of the device. It should be 0x68 or 0x69.

Optional propertied:
- interrupt-parent:  GPIO number
- interrupts:  GPIO macro
- invensense,orientation:  Orientation matrix for this device.

Example:

	icm20628@69 {
		compatible = "invensense,mpu6xxx";
                reg = <0x69>;
                interrupt-parent = <&gpio>;
                interrupts = <TEGRA_GPIO(X, 2) 0x01>;
                invensense,orientation = [ff 00 00 00 ff 00 00 00 01];
	};
```
