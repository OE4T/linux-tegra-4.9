/*
 * arch/arm64/boot/dts/tegra194-sim-vdk.dts
 *
 * Copyright (c) 2016, NVIDIA CORPORATION.  All rights reserved.
 *
 * This program is free software; you can redistribute it and/or modify
 * it under the terms of the GNU General Public License as published by
 * the Free Software Foundation; version 2 of the License.
 *
 */

#include "tegra194-sim-vdk-private.dts"

/ {
};
