/*
 * tegra186-super-module-e2614-a00-p2597-1000-a00-audio.dtsi: Jetson super module E2614
 *
 * Copyright (c) 2015, NVIDIA CORPORATION.  All rights reserved.
 *
 * This program is free software; you can redistribute it and/or modify
 * it under the terms of the GNU General Public License as published by
 * the Free Software Foundation; version 2 of the License.
 *
 * This program is distributed in the hope that it will be useful, but WITHOUT
 * ANY WARRANTY; without even the implied warranty of MERCHANTABILITY or
 * FITNESS FOR A PARTICULAR PURPOSE.  See the GNU General Public License for
 * more details.
 */

/ {
	sound {
		nvidia,hp-det-gpios = <&gpio TEGRA_GPIO(J , 5) GPIO_ACTIVE_HIGH>;
		nvidia,num-codec-link = <3>;

		nvidia,audio-routing =
			"y Headphone",		"y OUT",
			"y IN",			"y Mic",
			"z Headphone",		"z OUT",
			"z IN",			"z Mic",
			"x Headphone Jack",	"x HPO L Playback",
			"x Headphone Jack",	"x HPO R Playback",
			"x MICBIAS1",		"x Mic Jack",
			"x IN1P",		"x Mic Jack",
			"x Mic Det Power",	"x Mic Jack",
			"x Int Spk",		"x SPO Playback",
			"x DMIC L1",		"x Int Mic",
			"x DMIC L2",		"x Int Mic",
			"x DMIC R1",		"x Int Mic",
			"x DMIC R2",		"x Int Mic",
			"n Headphone",		"n OUT",
			"n IN",			"n Mic";

		nvidia,dai-link-3 {
			link-name = "rt565x-playback";
			cpu-dai = <&tegra_i2s1>;
			codec-dai = <&rt5658>;
			cpu-dai-name = "I2S1";
			codec-dai-name = "rt5659-aif1";
			format = "i2s";
			bitclock-slave;
			frame-slave;
			bitclock-noninversion;
			frame-noninversion;
			bit-format = "s16_le";
			bclk_ratio = <0>;
			srate = <48000>;
			num-channel = <2>;
			name-prefix = "x";
		};
		/* DSPK is disabled by default */
		nvidia,dai-link-4 {
			link-name = "dspk-playback";
			cpu-dai = <&tegra_dspk1>;
			codec-dai = <&tas2552>;
			cpu-dai-name = "DSPK1";
			codec-dai-name = "tas2552-amplifier";
			format = "i2s";
			bit-format = "s16_le";
			srate = <48000>;
			num-channel = <2>;
			codec = "0.spdif-dit.0";
			name-prefix = "n";
		};
	};
};
