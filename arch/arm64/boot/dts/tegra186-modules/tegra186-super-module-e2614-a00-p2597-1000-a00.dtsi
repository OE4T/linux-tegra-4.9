/*
 * tegra186-super-module-e2614-a00-p2597-1000-a00.dtsi: Jetson super module E2614
 *
 * Copyright (c) 2015, NVIDIA CORPORATION.  All rights reserved.
 *
 * This program is free software; you can redistribute it and/or modify
 * it under the terms of the GNU General Public License as published by
 * the Free Software Foundation; version 2 of the License.
 *
 * This program is distributed in the hope that it will be useful, but WITHOUT
 * ANY WARRANTY; without even the implied warranty of MERCHANTABILITY or
 * FITNESS FOR A PARTICULAR PURPOSE.  See the GNU General Public License for
 * more details.
 */

#include "tegra186-super-module-e2614-a00-p2597-1000-a00-common.dtsi"
#include "tegra186-super-module-e2614-a00-p2597-1000-a00-audio.dtsi"
