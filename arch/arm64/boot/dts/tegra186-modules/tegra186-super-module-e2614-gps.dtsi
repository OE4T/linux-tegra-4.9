/*
 * Copyright (c) 2015, NVIDIA CORPORATION.  All rights reserved.
 *
 * This program is free software; you can redistribute it and/or modify
 * it under the terms of the GNU General Public License as published by
 * the Free Software Foundation; either version 2 of the License, or
 * (at your option) any later version.
 *
 * This program is distributed in the hope that it will be useful, but WITHOUT
 * ANY WARRANTY; without even the implied warranty of MERCHANTABILITY or
 * FITNESS FOR A PARTICULAR PURPOSE.  See the GNU General Public License for
 * more details.
 *
 */

/ {
	gps_wake {
		compatible = "nvidia,tegra-gps-wake";
		id = <0>;
		gps-en = <&gpio_i2c_1_20 8 0>;
		gps-host-wake = <&gpio TEGRA_GPIO(Q, 5) 0>;
		interrupt-parent = <&gpio>;
		interrupts = <TEGRA_GPIO(Q, 5) 0x01>;
		status = "disabled";
	};
};
