/*
 * Copyright (c) 2015, NVIDIA CORPORATION.  All rights reserved.
 *
 * This program is free software; you can redistribute it and/or modify
 * it under the terms of the GNU General Public License as published by
 * the Free Software Foundation; either version 2 of the License, or
 * (at your option) any later version.
 *
 * This program is distributed in the hope that it will be useful, but WITHOUT
 * ANY WARRANTY; without even the implied warranty of MERCHANTABILITY or
 * FITNESS FOR A PARTICULAR PURPOSE.  See the GNU General Public License for
 * more details.
 *
 */

#include "tegra186-sunsteaker-slt-spmic-e3340-1099-a00-00.dtsi"
#include "tegra186-sunsteaker-slt-fixed-e3340-1099-a00-00.dtsi"
#include "tegra186-cvb-slt-p2598-a00-e3340-1099-a00-00.dtsi"

/ {
	host1x {
		nvdisplay@15200000 {
			avdd_lcd-supply = <&vdd_dis_3v3_lcd>;
			dvdd_lcd-supply = <&vdd_lcd_1v8_dis>;
			avdd_dsi_csi-supply = <&spmic_sd1>;
		};
                nvdisplay@15210000 {
                        avdd_hdmi-supply = <&spmic_ldo7>;
                        avdd_hdmi_pll-supply = <&spmic_sd2>;
                        vdd_hdmi_5v0-supply = <&vdd_hdmi0_5v0>;
                };
	};
};
