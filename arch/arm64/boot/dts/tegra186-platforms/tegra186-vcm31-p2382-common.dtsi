/*
 * tegra186-vcm31-p2382-common.dtsi: VCM3.1 based P2382(sunstreaker)
 * common dtsi.
 *
 * Copyright (c) 2015, NVIDIA CORPORATION.  All rights reserved.
 *
 * This program is free software; you can redistribute it and/or modify
 * it under the terms of the GNU General Public License as published by
 * the Free Software Foundation; version 2 of the License.
 *
 * This program is distributed in the hope that it will be useful, but WITHOUT
 * ANY WARRANTY; without even the implied warranty of MERCHANTABILITY or
 * FITNESS FOR A PARTICULAR PURPOSE.  See the GNU General Public License for
 * more details.
 */

#include <dt-bindings/types.h>
/dts-v1/;

/memreserve/ 0x80000000 0x00010000;

#include "tegra186-platforms/tegra186-vcm31.dtsi"

/ {
        model = "t186-vcm31-p2382";
        compatible = "nvidia,t186-vcm31-p2382", "nvidia,tegra186";

        nvidia,dtbbuildtime = __DATE__, __TIME__;
        #address-cells = <2>;
        #size-cells = <2>;

};

