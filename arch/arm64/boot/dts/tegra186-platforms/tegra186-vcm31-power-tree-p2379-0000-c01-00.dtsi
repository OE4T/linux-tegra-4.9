/*
 * Copyright (c) 2016, NVIDIA CORPORATION.  All rights reserved.
 *
 * This program is free software; you can redistribute it and/or modify
 * it under the terms of the GNU General Public License as published by
 * the Free Software Foundation; either version 2 of the License, or
 * (at your option) any later version.
 *
 * This program is distributed in the hope that it will be useful, but WITHOUT
 * ANY WARRANTY; without even the implied warranty of MERCHANTABILITY or
 * FITNESS FOR A PARTICULAR PURPOSE.  See the GNU General Public License for
 * more details.
 */

#include "tegra186-platforms/tegra186-vcm31-power-tree-p2379-0000-c00-00.dtsi"

/ {
	fixed-regulators {
		vdd_usb2_5v: regulator@4 {
			compatible = "regulator-fixed";
			reg = <4>;
			regulator-name = "vdd-usb2-5v";
			regulator-min-microvolt = <5000000>;
			regulator-max-microvolt = <5000000>;
			gpio = <&tegra_gpio TEGRA_GPIO(L, 5) 0>;
			enable-active-high;
			gpio-open-drain;
			vin-supply = <&vdd_1v8>;
		};
	};
};
