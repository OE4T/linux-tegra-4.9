/*
 * tegra186-priv-quill-p3310-1000-a00-00-module-2614-a00.dts:
 * Quill product board for android with super module 2614-a00
 *
 * Copyright (c) 2015, NVIDIA CORPORATION.  All rights reserved.
 *
 * This program is free software; you can redistribute it and/or modify
 * it under the terms of the GNU General Public License as published by
 * the Free Software Foundation; version 2 of the License.
 *
 * This program is distributed in the hope that it will be useful, but WITHOUT
 * ANY WARRANTY; without even the implied warranty of MERCHANTABILITY or
 * FITNESS FOR A PARTICULAR PURPOSE.  See the GNU General Public License for
 * more details.
 */

#include "tegra186-priv-quill-p3310-1000-a00-00-base.dts"
#include "tegra186-modules/tegra186-super-module-e2614-a00-p2597-1000-a00.dtsi"
#include "tegra186-platforms/tegra186-quill-shim-p3310-1000-a00-00.dtsi"

/ {
	nvidia,dtsfilename = __FILE__;
};
