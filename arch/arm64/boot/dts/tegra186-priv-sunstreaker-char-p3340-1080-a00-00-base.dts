/*
 * tegra186-sunstreaker-p3340-1080-a00-00-base.dts Sunstreaker-CHAR A00 Board
 *
 * Copyright (c) 2015, NVIDIA CORPORATION.  All rights reserved.
 *
 * This program is free software; you can redistribute it and/or modify
 * it under the terms of the GNU General Public License as published by
 * the Free Software Foundation; version 2 of the License.
 *
 * This program is distributed in the hope that it will be useful, but WITHOUT
 * ANY WARRANTY; without even the implied warranty of MERCHANTABILITY or
 * FITNESS FOR A PARTICULAR PURPOSE.  See the GNU General Public License for
 * more details.
 */

#include "tegra186-platforms/tegra186-sunstreaker-p3340-common.dtsi"

/ {
	nvidia,dtsfilename = __FILE__;
	nvidia,boardids = "3340:1080:A0";
	nvidia,proc-boardid = "3340:1080:A0";
};
