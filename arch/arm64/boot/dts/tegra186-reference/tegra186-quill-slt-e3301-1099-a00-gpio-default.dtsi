/*
 * Copyright (c) 2015, NVIDIA CORPORATION.  All rights reserved.
 *
 * This program is free software; you can redistribute it and/or modify
 * it under the terms of the GNU General Public License as published by
 * the Free Software Foundation; either version 2 of the License, or
 * (at your option) any later version.
 *
 * This program is distributed in the hope that it will be useful, but WITHOUT
 * ANY WARRANTY; without even the implied warranty of MERCHANTABILITY or
 * FITNESS FOR A PARTICULAR PURPOSE.  See the GNU General Public License for
 * more details.
 */

#include <dt-bindings/gpio/tegra-gpio.h>

/ {
	gpio@2200000 {
		gpio-init-names = "default";
		gpio-init-0 = <&gpio_default>;

		gpio_default: default {
			gpio-input = <
				TEGRA_GPIO(B, 5)
				TEGRA_GPIO(C, 0)
				TEGRA_GPIO(J, 5)
				TEGRA_GPIO(M, 5)
				TEGRA_GPIO(I, 4)
				TEGRA_GPIO(I, 6)
				TEGRA_GPIO(I, 7)
				TEGRA_GPIO(FF, 1)
				TEGRA_GPIO(FF, 2)
				TEGRA_GPIO(FF, 3)
				TEGRA_GPIO(FF, 4)
				TEGRA_GPIO(FF, 0)
				TEGRA_GPIO(Y, 0)
				TEGRA_GPIO(Y, 1)
				TEGRA_GPIO(Y, 2)
				TEGRA_GPIO(Y, 5)
				TEGRA_GPIO(Y, 6)
				TEGRA_GPIO(V, 0)
				TEGRA_GPIO(V, 5)
				TEGRA_GPIO(AA, 3)
				TEGRA_GPIO(AA, 4)
				TEGRA_GPIO(AA, 5)
				TEGRA_GPIO(AA, 7)
				>;
			gpio-output-low = <
				TEGRA_GPIO(B, 4)
				TEGRA_GPIO(B, 6)
				TEGRA_GPIO(J, 6)
				TEGRA_GPIO(M, 4)
				TEGRA_GPIO(I, 5)
				TEGRA_GPIO(N, 0)
				TEGRA_GPIO(U, 3)
				TEGRA_GPIO(S, 3)
				TEGRA_GPIO(Y, 4)
				TEGRA_GPIO(H, 4)
				TEGRA_GPIO(H, 5)
				TEGRA_GPIO(H, 6)
				TEGRA_GPIO(L, 6)
				TEGRA_GPIO(AA, 2)
				>;
			gpio-output-high = <
				>;
		};
	};
};

