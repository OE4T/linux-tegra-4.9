/*
 * tegra186-soc-ufshc.dtsi: Tegra186 soc dtsi file for UFS host controller
 *
 * Copyright (c) 2015, NVIDIA CORPORATION.  All rights reserved.
 *
 * This program is free software; you can redistribute it and/or modify
 * it under the terms of the GNU General Public License as published by
 * the Free Software Foundation; version 2 of the License.
 *
 * This program is distributed in the hope that it will be useful, but WITHOUT
 * ANY WARRANTY; without even the implied warranty of MERCHANTABILITY or
 * FITNESS FOR A PARTICULAR PURPOSE.  See the GNU General Public License for
 * more details.
 */

#include "../../../../include/dt-bindings/pinctrl/pinctrl-tegra-padctl-uphy.h"

/ {

	ufshci@2450000 {
		compatible = "jedec,ufs-1.1";
		reg = <0x0 0x02450000 0x0 0x4000>;
		interrupts = < 0 TEGRA186_IRQ_UFSHC 0x04 >;
		#stream-id-cells = <1>;
		clocks = <&tegra_car TEGRA186_CLK_MPHY_CORE_PLL_FIXED>,
				<&tegra_car TEGRA186_CLK_MPHY_L0_TX_SYMB>,
				<&tegra_car TEGRA186_CLK_MPHY_TX_1MHZ_REF> ,
				<&tegra_car TEGRA186_CLK_MPHY_L0_RX_ANA>,
				<&tegra_car TEGRA186_CLK_MPHY_L0_RX_SYMB>,
				<&tegra_car TEGRA186_CLK_MPHY_L0_TX_LS_3XBIT>,
				<&tegra_car TEGRA186_CLK_MPHY_L0_RX_LS_BIT>,
				<&tegra_car TEGRA186_CLK_MPHY_L1_RX_ANA>,
				<&tegra_car TEGRA186_CLK_UFSHC>,
				<&tegra_car TEGRA186_CLK_UFSDEV_REF>,
				<&tegra_car TEGRA186_CLK_PLLP_OUT0>,
				<&tegra_car TEGRA186_CLK_CLK_M>;
		clock-names = "mphy_core_pll_fixed", "mphy_l0_tx_symb",
				"mphy_tx_1mhz_ref", "mphy_l0_rx_ana",
				"mphy_l0_rx_symb", "mphy_l0_tx_ls_3xbit",
				"mphy_l0_rx_ls_bit", "mphy_l1_rx_ana",
				"ufshc", "ufsdev_ref", "pll_p", "clk_m";
		resets = <&tegra_car TEGRA186_RESET_MPHY_L0_RX>,
				<&tegra_car TEGRA186_RESET_MPHY_L0_TX>,
				<&tegra_car TEGRA186_RESET_MPHY_L1_RX>,
				<&tegra_car TEGRA186_RESET_MPHY_L1_TX>,
				<&tegra_car TEGRA186_RESET_MPHY_CLK_CTL>,
				<&tegra_car TEGRA186_RESET_UFSHC>,
				<&tegra_car TEGRA186_RESET_UFSHC_AXI_M>,
				<&tegra_car TEGRA186_RESET_UFSHC_LP>;
		reset-names = "mphy-l0-rx-rst", "mphy-l0-tx-rst", "mphy-l1-rx-rst",
				"mphy-l1-tx-rst", "mphy-clk-ctl-rst", "ufs-rst",
				"ufs-axi-m-rst", "ufshc-lp-rst";
		nvidia,enable-x2-config;
		nvidia,mask-fast-auto-mode;
		nvidia,mask-hs-mode-b;
		nvidia,max-hs-gear = <1>;
		nvidia,max-pwm-gear = <4>;
		phys = <&tegra_padctl_uphy TEGRA_PADCTL_UPHY_UFS_P(0)>;
		phy-names = "uphy";
		status = "disabled";

		ufs_variant {
			compatible = "tegra,ufs_variant";
		};
	};
};

