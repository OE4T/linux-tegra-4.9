## arch/arm64/configs/tegra_gnu_linux_early_boot_defconfig
```kconfig
CONFIG_ARCH_TEGRA_18x_SOC=y
CONFIG_ARCH_TEGRA_19x_SOC=y
# CONFIG_LOCALVERSION_AUTO is not set
CONFIG_SYSVIPC=y
# CONFIG_FHANDLE is not set
CONFIG_USELIB=y
CONFIG_NO_HZ=y
CONFIG_HIGH_RES_TIMERS=y
CONFIG_BLK_DEV_INITRD=y
CONFIG_EMBEDDED=y
# CONFIG_SLUB_DEBUG is not set
CONFIG_JUMP_LABEL=y
CONFIG_CC_STACKPROTECTOR_STRONG=y
CONFIG_MODULES=y
# CONFIG_BLK_DEV_BSG is not set
CONFIG_ARCH_TEGRA=y
# CONFIG_ARM64_ERRATUM_843419 is not set
CONFIG_PREEMPT=y
CONFIG_KSM=y
CONFIG_CMA=y
CONFIG_ARMV8_DEPRECATED=y
CONFIG_SWP_EMULATION=y
CONFIG_CP15_BARRIER_EMULATION=y
CONFIG_SETEND_EMULATION=y
# CONFIG_ARM64_VHE is not set
CONFIG_RANDOMIZE_BASE=y
# CONFIG_EFI is not set
CONFIG_COMPAT=y
CONFIG_NET=y
CONFIG_PACKET=y
CONFIG_INET=y
# CONFIG_INET_XFRM_MODE_TUNNEL is not set
# CONFIG_INET_XFRM_MODE_BEET is not set
# CONFIG_INET_DIAG is not set
# CONFIG_ANDROID_PARANOID_NETWORK is not set
CONFIG_DEVTMPFS=y
CONFIG_DEVTMPFS_MOUNT=y
CONFIG_DMA_CMA=y
CONFIG_CMA_SIZE_MBYTES=64
CONFIG_TEGRA_HV_BLKDEV=y
CONFIG_NETDEVICES=y
# CONFIG_NET_VENDOR_AMAZON is not set
CONFIG_TEGRA_HV_NET=y
# CONFIG_INPUT_MOUSE is not set
# CONFIG_LEGACY_PTYS is not set
# CONFIG_DEVKMEM is not set
CONFIG_SERIAL_8250=y
CONFIG_SERIAL_8250_CONSOLE=y
CONFIG_SERIAL_OF_PLATFORM=y
CONFIG_SERIAL_TEGRA=y
CONFIG_TEGRA_HV_COMM=y
# CONFIG_HW_RANDOM is not set
CONFIG_I2C_CHARDEV=y
CONFIG_I2C_TEGRA=y
CONFIG_SYSTEM_PMIC=y
CONFIG_TRUSTY=y
CONFIG_WATCHDOG=y
CONFIG_WATCHDOG_CORE=y
CONFIG_TEGRA_HV_WATCHDOG=y
CONFIG_TEGRA18X_WATCHDOG=y
CONFIG_REGULATOR=y
CONFIG_REGULATOR_PMIC_OTP=y
CONFIG_REGULATOR_FIXED_VOLTAGE=y
CONFIG_REGULATOR_GPIO=y
CONFIG_MEDIA_SUPPORT=y
CONFIG_MEDIA_CAMERA_SUPPORT=y
CONFIG_MEDIA_CONTROLLER=y
CONFIG_VIDEO_V4L2_SUBDEV_API=y
CONFIG_V4L_PLATFORM_DRIVERS=y
CONFIG_VIDEO_CAMERA=y
CONFIG_VIDEO_ISC=y
CONFIG_FB=y
CONFIG_BACKLIGHT_LCD_SUPPORT=y
CONFIG_NVMAP_CACHE_MAINT_BY_SET_WAYS=y
CONFIG_NVMAP_CACHE_MAINT_BY_SET_WAYS_ON_ONE_CPU=y
CONFIG_TEGRA_GR_VIRTUALIZATION=y
CONFIG_TEGRA_GRHOST=y
CONFIG_TEGRA_NVDISPLAY=y
CONFIG_TEGRA_DSI=y
CONFIG_TEGRA_DSI2EDP_SN65DSI86=y
CONFIG_TEGRA_HDMI2_0=y
CONFIG_TEGRA_HDMI2FPD_DS90UH949=y
CONFIG_TEGRA_DC=y
CONFIG_SOUND=y
CONFIG_SND=y
CONFIG_SND_SOC=y
CONFIG_SND_SOC_TEGRA_ALT=y
CONFIG_SND_SOC_TEGRA_VIRT_T210REF_PCM=y
CONFIG_SND_SOC_SPDIF=y
CONFIG_SWITCH=y
CONFIG_DMADEVICES=y
CONFIG_TEGRA210_ADMA=y
CONFIG_TEGRA186_GPC_DMA=y
CONFIG_SYNC_FILE=y
CONFIG_VIRT_DRIVERS=y
CONFIG_TEGRA_VIRTUALIZATION=y
CONFIG_TEGRA_HV_MANAGER=y
CONFIG_STAGING=y
# CONFIG_TEGRA3_PM is not set
# CONFIG_TEGRA_NVDUMPER is not set
CONFIG_DENVER_CPU=y
CONFIG_TEGRA_BWMGR=y
CONFIG_TEGRA_ISOMGR=y
CONFIG_TEGRA_FIRMWARES_INVENTORY=y
CONFIG_TEGRA_AON=y
CONFIG_TEGRA_18X_SERROR=y
CONFIG_TEGRA_CAMERA_RTCPU=y
CONFIG_TEGRA_NVADSP=y
# CONFIG_COMMON_CLK_XGENE is not set
CONFIG_MAILBOX=y
CONFIG_ARM_SMMU=y
CONFIG_PM_DEVFREQ=y
CONFIG_RAS=y
CONFIG_GK20A_PMU=y
CONFIG_TEGRA_ACR=y
CONFIG_EXT4_FS=y
CONFIG_EXT4_FS_POSIX_ACL=y
CONFIG_EXT4_FS_SECURITY=y
# CONFIG_DNOTIFY is not set
CONFIG_NLS=y
CONFIG_NLS_CODEPAGE_437=y
CONFIG_NLS_ISO8859_1=y
CONFIG_NLS_UTF8=y
CONFIG_PRINTK_TIME=y
CONFIG_DEBUG_FS=y
CONFIG_DEBUG_SECTION_MISMATCH=y
CONFIG_LOCKUP_DETECTOR=y
CONFIG_WQ_WATCHDOG=y
CONFIG_PANIC_TIMEOUT=5
# CONFIG_DEBUG_PREEMPT is not set
CONFIG_STACKTRACE=y
# CONFIG_FTRACE is not set
CONFIG_HARDENED_USERCOPY=y
CONFIG_CRYPTO_ECDH=y
CONFIG_CRYPTO_AUTHENC=y
CONFIG_CRYPTO_ECHAINIV=y
CONFIG_CRYPTO_CBC=y
CONFIG_CRYPTO_CTR=y
CONFIG_CRYPTO_ECB=y
CONFIG_CRYPTO_CMAC=m
CONFIG_CRYPTO_GHASH=y
CONFIG_CRYPTO_MD5=y
CONFIG_CRYPTO_SHA1=y
CONFIG_CRYPTO_ARC4=y
CONFIG_CRYPTO_DES=y
CONFIG_CRYPTO_DEFLATE=y
CONFIG_TEGRA_CRYPTO_DEV=y
CONFIG_CRYPTO_DEV_TEGRA_ELLIPTIC_SE=y
CONFIG_CRYPTO_DEV_TEGRA_SE=y
CONFIG_ARM64_CRYPTO=y
CONFIG_CRYPTO_SHA1_ARM64_CE=y
CONFIG_CRYPTO_SHA2_ARM64_CE=y
CONFIG_CRYPTO_GHASH_ARM64_CE=y
CONFIG_CRYPTO_AES_ARM64_CE_CCM=y
CONFIG_CRYPTO_AES_ARM64_CE_BLK=y
CONFIG_CRYPTO_CRC32_ARM64=y
CONFIG_CRC_CCITT=y
CONFIG_CRC_T10DIF=y
CONFIG_CRC_ITU_T=y
CONFIG_CRC7=y
CONFIG_LIBCRC32C=y
CONFIG_TEGRA_BPMP=y
```

## drivers/Kconfig
```kconfig
append_menu "Device Drivers"

if ARCH_TEGRA
source "drivers/misc/tegra186-ahc/Kconfig"
source "drivers/nvpmodel/Kconfig"
source "drivers/nvlink/Kconfig"
source "drivers/iommu/Kconfig"
source "drivers/nvpps/Kconfig"
source "drivers/thermal/Kconfig"
source "drivers/trusty/Kconfig"
source "drivers/virt/tegra/Kconfig"
endif

endmenu
```

## drivers/ata/Kconfig
```kconfig
if ATA
config AHCI_TEGRA_DOWNSTREAM
	tristate "TEGRA AHCI SATA support"
	select ARCH_TEGRA_HAS_SATA
	help
	  This option enables support for TEGRA AHCI Serial ATA.

	  If unsure, say N.
endif # ATA
```

## drivers/clk/tegra/Kconfig
```kconfig
config TEGRA_CLK_EMC
	def_bool y
	depends on TEGRA124_EMC

config TEGRA_CLK_DEBUG
	def_bool y
	depends on DEBUG_FS
	---help---
	Enable debugfs entries to change clock parent/rate/state
```

## drivers/crypto/Kconfig
```kconfig
config CRYPTO_DEV_TEGRA_SE_USE_HOST1X_INTERFACE
	tristate "Use Host1x Interface for Tegra SE crypto algorithms"
	depends on ARCH_TEGRA_18x_SOC && CRYPTO_DEV_TEGRA_SE
	help
	  This allows you to use Host1x Memory Interface for Tegra SE Driver
	  Crypto algorithms.
```

## drivers/crypto/Kconfig.nvidia
```kconfig
config TEGRA_CRYPTO_DEV
	tristate "Device node to access tegra aes hardware"
	depends on CRYPTO_DEV_TEGRA_ELLIPTIC_SE
	help
	  Dev node /dev/tegra-crypto in order to get access to tegra aes
	  hardware from user space

config CRYPTO_DEV_TEGRA_SE_USE_HOST1X_INTERFACE
	tristate "Use Host1x Interface for Tegra SE crypto algorithms"
	depends on ARCH_TEGRA_18x_SOC
	help
	  This allows you to use Host1x Memory Interface for Tegra SE Driver
	  Crypto algorithms.

config CRYPTO_DEV_TEGRA_VIRTUAL_SE_INTERFACE
        tristate "Virtual SE interface for Tegra SE crypto algorithms"
        depends on ARCH_TEGRA_18x_SOC && CRYPTO_DEV_TEGRA_SE
        help
          This allows you to use Virtual SE interface for Tegra Crypto algorithms.
```

## drivers/crypto/elliptic/Kconfig.t18x
```kconfig
# SE Elliptic Engine Driver
config CRYPTO_DEV_TEGRA_ELLIPTIC_SE
	tristate "Tegra SE for Elliptic crypto algorithms"
	depends on ARCH_TEGRA_18x_SOC
	help
	   This option allows you to have support of Security Engine for Elliptic
	   Crypto Algorithms
```

## drivers/dma/Kconfig
```kconfig
config TEGRA186_GPC_DMA
	bool "NVIDIA Tegra186 GPC DMA support"
	depends on ARCH_TEGRA_18x_SOC
	select DMA_ENGINE
	help
	  Support for the NVIDIA Tegra186 GPC DMA controller driver. The
	  DMA controller is having multiple DMA channel which can be
	  configured for different peripherals like UART, SPI, etc which
	  are on APB bus.
	  This DMA controller transfers data from memory to peripheral fifo
	  or vice versa. It also supports memory to memory data transfer.

config TEGRA186_ADMA
	bool "NVIDIA Tegra186 ADMA support"
	depends on PLATFORM_TEGRA && ARCH_TEGRA_APE
	depends on TEGRA_APE_AGIC && ARCH_TEGRA_18x_SOC
	select DMA_ENGINE
	help
	  Support for the NVIDIA Tegra186 ADMA controller driver. The
	  DMA controller is having multiple DMA channel and it configured
	  for audio.This DMA controller transfers data from  memory to
	  peripheral fifo or vice versa. It does not support memory to
	  memory data transfer.
```

## drivers/firmware/tegra/Kconfig
```kconfig
menu "Tegra BPMP Driver"

config TEGRA_BPMP
	bool "Tegra BPMP driver"
	default n
	select TEGRA_IVC
	select TEGRA_HSP
	help
	  Manages firmware running on Tegra BPMP

config BPMP_DEBUGFS_MOUNT_ON_BOOT
	bool "Mount the BPMP debug fs on boot"
	default y
	depends on DEBUG_FS
	help
	  Disable this if you don't want to mount the BPMP debug fs by default
	  on boot.

	  Note disabling this will save some boot time. BPMP debugfs still can
	  be mounted after the boot.

endmenu
```

## drivers/gpio/Kconfig
```kconfig
if GPIOLIB

config GPIO_TEGRA186
	bool "NVIDIA Tegra186 GPIO support"
	select GPIO_SYSFS
	default y if ARCH_TEGRA_18x_SOC || ARCH_TEGRA_19x_SOC
	help
	Support for the NVIDIA Tegra186 GPIO controller driver.

endif
```

## drivers/gpu/nvgpu/Kconfig
```kconfig
config TEGRA_19x_GPU
	bool "Tegra 19x family GPU"
	depends on GK20A && ARCH_TEGRA_19x_SOC
	default y
	help
	  Support for NVIDIA Tegra 19x family of GPU
```

## drivers/hid/Kconfig
```kconfig
append_menu "HID support"

menu "SHIELD accessory HID drivers"

config HID_SHIELD_BLAKE
	tristate "SHIELD game controller"
	depends on USB_HID
	---help---
	Support for NVIDIA SHIELD game controller.

config HID_SHIELD_REMOTE
	tristate "SHIELD remote control support"
	depends on USB_HID
	---help---
	Support for NVIDIA SHIELD remote control.

endmenu

endmenu
```

## drivers/i2c/busses/Kconfig.nvidia
```kconfig
config I2C_TEGRA_VI
        tristate "NVIDIA Tegra internal VII2C controller"
        depends on ARCH_TEGRA
        default y
        select I2C_ALGOBIT
        help
          If you say yes to this option, support will be included for the
          I2C controller embedded in NVIDIA Tegra SOCs
```

## drivers/i2c/busses/Kconfig.t18x
```kconfig
config I2C_BPMP_TEGRA
	tristate "NVIDIA Tegra internal BPMP I2C controller"
	depends on TEGRA_BPMP
	default y
	select I2C_ALGO_BUSCLEAR
	select I2C_ALGOBIT
	help
	  If you say yes to this option, support will be included for the
	  I2C controller embedded in NVIDIA Tegra SOCs accessed via BPMP.
	  This I2C driver is a 'virtual' I2C driver. The real driver is
	  embedded in the BPMP firmware, and this driver merely communicates
	  with that real driver.
config TEGRA_I2CSLV_T186
	bool "Tegra i2c slave controller driver"
	default y
	help
	  Enable on-chip i2c slave controller.

config I2C_TEGRA_CAMRTC
	bool "Tegra I2C Camera RTCPU driver"
	depends on TEGRA_CAMERA_RTCPU
	help
	  If you say yes to this option, support will be included for the
	  I2C controller embedded in NVIDIA Tegra SOCs accessed via Camera
	  RTCPU processor. This I2C driver is a 'virtual' I2C driver
	  compatible with I2C bus driver. The real driver is embedded in the
	  Camera RTCPU firmware, and this driver merely communicates with
	  that real driver.
```

## drivers/i2c/busses/Kconfig.t19x
```kconfig
config I2C_TEGRA194_SLAVE
	tristate "NVIDIA Tegra194 internal I2C slave controller"
	select I2C_SLAVE
	help
	If you say yes to this option, support will be included for the
	I2C slave controller embedded in NVIDIA Tegra194 SOC.

	This driver supports FIFO mode for read/write transfers.
```

## drivers/iio/common/nvs/Kconfig
```kconfig
#
# NVidiaSensor IIO common
#
config NVS_IIO
	tristate "Common module for NVSensor IIO drivers"
	depends on SYSFS && IIO && IIO_KFIFO_BUF && IIO_TRIGGER
	default n
	help
	  Support for IIO NVSensor framework.
```

## drivers/iio/imu/Kconfig
```kconfig
append_menu "Inertial measurement units"
source "drivers/iio/imu/nvi_mpu/Kconfig"
endmenu
```

## drivers/iio/imu/nvs_bmi/Kconfig
```kconfig
config NVS_BMI160
	tristate "Bosch BMI160 IMU"
	depends on I2C && SYSFS && IIO && IIO_KFIFO_BUF && IIO_TRIGGER && !INV_MPU
	select NVS_IIO
	default n
	help
	  Enable Bosch BMI160 IMU
```
