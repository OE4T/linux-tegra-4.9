/*
 * Copyright (c) 2017, NVIDIA CORPORATION.  All rights reserved.
 *
 * This program is free software; you can redistribute it and/or modify
 * it under the terms of the GNU General Public License as published by
 * the Free Software Foundation; version 2 of the License.
 *
 * This program is distributed in the hope that it will be useful, but WITHOUT
 * ANY WARRANTY; without even the implied warranty of MERCHANTABILITY or
 * FITNESS FOR A PARTICULAR PURPOSE.  See the GNU General Public License for
 * more details.
 */

#include <t19x-common-modules/tegra194-cvb-p2822-0000-a00.dtsi>
#include <dt-bindings/gpio/tegra194-gpio.h>

/ {
	sdhci@3400000 {
		uhs-mask = <0x1F>;
		mmc-ocr-mask = <0x0>;
		nvidia,disable-rtpm;
		cd-gpios = <&tegra_main_gpio TEGRA194_MAIN_GPIO(G, 7) 0>;
		status = "okay";
	};
};
