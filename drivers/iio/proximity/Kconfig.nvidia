## drivers/input/touchscreen/Kconfig.nvidia
```kconfig
config TOUCHSCREEN_NVIDIA_ATMEL_MXT
        tristate "NVIDIA Atmel mXT I2C Touchscreen"
        depends on I2C
        select FW_LOADER
        help
          Say Y here if you have Atmel mXT series I2C touchscreen,
          such as AT42QT602240/ATMXT224, connected to your system.

          If unsure, say N.

          To compile this driver as a module, choose M here: the
          module will be called atmel_mxt_ts.

          It is Nvidia Atmel driver which is impoved based on
          atmel k3.14 driver.

config TOUCHSCREEN_LR388K7
	tristate "Sharp LR388K7 touchscreen"
	depends on SPI_MASTER
	help
	  Say Y here if you have a LR388K7 and want to enable
	  support for the built-in touchscreen.

	  If unsure, say N.

	  To compile this driver as a module, choose M here: the
	  module will be called lr388k7.

config TOUCHSCREEN_RM31080A
	tristate "RAYDIUM_31080A based touchscreens"
	depends on SPI_MASTER
	help
	  Say Y here if you have a touchscreen interface using the
	  RAYDIUM_T31080A controller, and your board-specific initialization
	  code includes that in its table of SPI devices.

	  If unsure, say N (but it's safe to say "Y").

	  To compile this driver as a module, choose M here: the
	  module will be called RAYDIUM_31080A.
```

## drivers/iommu/Kconfig
```kconfig
config TEGRA_ARM_SMMU_T19x
	bool "TEGRA ARM SMMU for T19x"
	depends on ARM_SMMU
	default n
	help
	  Support for implementations of the ARM System MMU architecture
	  versions 1 and 2 for T19x based architectures.

	  Say Y here if your SoC includes an IOMMU device implementing
	  the ARM SMMU architecture for T19x based architectures.
```

## drivers/media/platform/Kconfig
```kconfig
menu "NVIDIA overlay V4L platform devices"
source "drivers/media/platform/tegra/Kconfig"
endmenu
```

## drivers/media/platform/tegra/Kconfig
```kconfig
config VIDEO_ISC
	tristate "ISC(Image Sensor Control) device support"
	depends on I2C && PLATFORM_TEGRA
	---help---
	 This is a driver for the ISC
	 for controlling power, interrupt and registering
	 i2c clients related to image sensor.

trysource "../nvidia/drivers/media/platform/tegra/Kconfig.nvidia"
```

## drivers/misc/Kconfig.nvidia
```kconfig
config MODS
	tristate "NVIDIA MODS driver"
	default n
	---help---
	The NVIDIA MODS driver gives user space software direct access to
	hardware.  The NVIDIA Diagnostic Software uses this to test hardware.
	This driver should normally be disabled in all production builds.

	Say Y here to compile the NVIDIA MODS driver into the kernel or say M
	to compile it as a module.

	If unsure, say N here.

config SAF775x_HWDEP
        tristate "SAF775x HWDEP Driver"
        default n
        depends on I2C || SPI

config SAF36XX_HWDEP
        tristate "SAF36XX HWDEP Driver"
        default n
        depends on SPI && SPI_MASTER
        help
          Provides interfaces for flashing SAF36XX

config SENSORS_NCT1008
	tristate "ON Semiconductor Temperature Sensor"
	default n
	depends on I2C
	help
	 Say yes here if you wish to include the ON Semiconductor
	 NCT1008 Temperature sensor.

config THERM_EST
	bool "Thermal estimator driver"
	default n
	---help---
	Thermal driver which estimates temperature based of other sensors.

config FAN_THERM_EST
	tristate "Fan driving temp estimator"
	---help---
	Thermal driver that estimates the fan driving temperature based on
	other sensors.

	This enables a virtual sensor that polls other registered thermal
	zone devices for temperature updates.

trysource "../nvidia/drivers/misc/nvs-dfsh/Kconfig.nvidia"
```

## drivers/misc/Kconfig.t19x
```kconfig
config TEGRA_PCIE_EP_MEM
	tristate "Client driver for Tegra PCIe end point"
	depends on PCI
	help
	 Say Y if Tegra is working in PCIe-End Point mode and a client
	 driver is required
```

## drivers/misc/csi_mipi_cal/Kconfig
```kconfig
config T186_CSI_MIPI_CAL
	bool "Tegra186 CSI MIPI Calibration driver"
	select REGMAP_MMIO
	help
     Say Y or M if you want to add support for T186 CSI MIPI Calibration
```

## drivers/misc/tegra-cec/Kconfig
```kconfig
menuconfig TEGRA_CEC_SUPPORT
	bool "Tegra CEC support"
	depends on ARCH_TEGRA
	---help---
	  Say Y here to get to see options for tegra CEC support.
	  This option alone does not add any kernel code.

	  If you say N, all options in this submenu will be skipped and disabled.

if TEGRA_CEC_SUPPORT

config TEGRA_CEC_T30
	bool "Enable T30 CEC support"
	---help---
	 Adds HDMI-CEC driver for T30.

	 Disabled by default. Choose Y here if you want to build the driver.

endif # TEGRA_CEC_SUPPORT
```

## drivers/net/dsa/mv88e6xxx/Kconfig
```kconfig
config NET_DSA_MV88E6XXX
	tristate "Marvell 88E6xxx Ethernet switch fabric support"
	depends on NET_DSA
	select IRQ_DOMAIN
	select NET_DSA_TAG_EDSA
	select NET_DSA_TAG_DSA
	help
	  This driver adds support for most of the Marvell 88E6xxx models of
	  Ethernet switch chips, except 88E6060.

config NET_DSA_MV88E6XXX_GLOBAL2
	bool "Switch Global 2 Registers support"
	default y
	depends on NET_DSA_MV88E6XXX
	help
	  This registers set at internal SMI address 0x1C provides extended
	  features like EEPROM interface, trunking, cross-chip setup, etc.

	  It is required on most chips. If the chip you compile the support for
	  doesn't have such registers set, say N here. In doubt, say Y.

config NET_DSA_MIOVISION_MV88E6390
	bool "Support for the MV88E6390 Network Switch attached to the Jetson"
	default n
	depends on NET_DSA_MV88E6XXX
	help
	  The MV88E6390 does not respond properly to the PORT_SWITCH_ID call, so we force it on by
	  use of this flag.
```

## drivers/net/ethernet/Kconfig
```kconfig
#
# Ethernet LAN device configuration
#

if ETHERNET

source "drivers/net/ethernet/realtek/Kconfig"

endif # ETHERNET
```

## drivers/net/ethernet/nvidia/eqos/Kconfig
```kconfig
# Copyright (c) 2015, NVIDIA CORPORATION.  All rights reserved.
#
# This program is free software; you can redistribute it and/or modify it
# under the terms and conditions of the GNU General Public License,
# version 2, as published by the Free Software Foundation.
#
# This program is distributed in the hope it will be useful, but WITHOUT
# ANY WARRANTY; without even the implied warranty of MERCHANTABILITY or
# FITNESS FOR A PARTICULAR PURPOSE.  See the GNU General Public License for
# more details.

config EQOS
	tristate "NVIDIA Tegra Ethernet QOS driver"
	default n

	---help---
	  If you have a network (Ethernet) card belonging to this class, say Y
	  and read the Ethernet-HOWTO, available from
	  <http://www.tldp.org/docs.html#howto>.

	  Note that the answer to this question doesn't directly affect the
	  kernel: saying N will just cause the configurator to skip all
	  the questions about NVIDIA cards. If you say Y, you will be asked for
	  your specific card in the following questions.
```

## drivers/padctrl/Kconfig
```kconfig
menuconfig PADCTRL
	bool "Pad controller support"
	help
	  Say Y here to enable pad controller support

	  This framework provides a generic interface to PAD
	  devices.

if PADCTRL
config PADCTRL_GENERIC_TEGRA_IO_PAD
	bool "Generic Tegra IO Pad control driver"
	depends on ARCH_TEGRA
	help
	  This option enables Genric Tegra IO PAD padctrl driver

	  Tegra IO Pad padctrl driver which controls the IO pad
	  configuration for 1.2V, 1.8V and 3.3V.
endif
```

## drivers/pci/dwc/Kconfig
```kconfig
config PCIE_TEGRA_DW_HOST
	tristate "Nvidia Tegra PCIe host controller (T19x)"
	depends on PCI
	depends on ARCH_TEGRA
	select PCIEPORTBUS
	depends on PCI_MSI_IRQ_DOMAIN
	select PCIE_DW_HOST

config PCIE_TEGRA_DW_DMA_TEST
	bool "DMA test framework"
	depends on PCIE_TEGRA_DW_HOST
	help
	 Say Y here if you want to enable test framework for the DMA which is
	 integrated into root port. Please note that this framework should be
	 used only for testing purposes and enabling it would have security
	 implications. If you are not sure, select NO.
```

## drivers/pci/host/Kconfig.t19x
```kconfig
config PCIE_TEGRA_DW
	tristate "NVIDIA Tegra DesignWare Core based PCIe controller"
	depends on ARCH_TEGRA
	select PCIEPORTBUS
	select PCIE_DW
	help
	 Say Y here if you want support for the next gen PCIe host controller
	 which is based on Synopsys DesignWare IP suite found on next gen
	 NVIDIA Tegra SoCs.
```

## drivers/pinctrl/Kconfig
```kconfig
config PINCTRL_TEGRA186
	bool "NVIDIA Tegra186 Pinmux support"
	select PINCTRL_TEGRA
	help
	Support for the NVIDIA Tegra186 PINCTRL controller driver.
```

## drivers/pinctrl/Kconfig.t19x
```kconfig
config PINCTRL_TEGRA194
	bool "NVIDIA Tegra194 Pinmux support"
	select PINCTRL_TEGRA
	help
	Support for the NVIDIA Tegra194 PINCTRL controller driver.

config PINCTRL_TEGRA194_PEXCLK_PADCTL
	bool "NVIDIA Tegra194 PCIE PEXCLK PADCTL Driver"
	depends on ARCH_TEGRA_19x_SOC
	select PINCONF
	select PINMUX
	help
	  Support for the NVIDIA Tegra194 PCIE PEXCLK Padcontrol
	  configurations. This will provide the mechanism to dynamically
	  select the functionality between camera and PCIE.
```

## drivers/platform/Kconfig
```kconfig
if X86
source "drivers/platform/x86/Kconfig"
endif
if MIPS
source "drivers/platform/mips/Kconfig"
endif

source "drivers/platform/goldfish/Kconfig"

source "drivers/platform/chrome/Kconfig"

config PLATFORM_TEGRA
	bool "NVIDIA Tegra platform"
	default y if ARCH_TEGRA
	help
	  Enable support for misc Tegra drivers.

if PLATFORM_TEGRA
source "drivers/platform/tegra/Kconfig"
endif
```

## drivers/platform/tegra/Kconfig
```kconfig
# Copyright (c) 2012-2018, NVIDIA CORPORATION.  All rights reserved.
#
# This program is free software; you can redistribute it and/or modify it
# under the terms and conditions of the GNU General Public License,
# version 2, as published by the Free Software Foundation.
#
# This program is distributed in the hope it will be useful, but WITHOUT
# ANY WARRANTY; without even the implied warranty of MERCHANTABILITY or
# FITNESS FOR A PARTICULAR PURPOSE.  See the GNU General Public License for
# more details.
#
# You should have received a copy of the GNU General Public License
# along with this program.  If not, see <http://www.gnu.org/licenses/>.

comment "NVIDIA Tegra options"

config TEGRA_WAKEUP_MONITOR
	bool "Enable tegra wakeup monitor"
	depends on PM_SLEEP && ANDROID_INTF_ALARM_DEV
	help
	  This option enables support for the monitor of tegra wakeups, it will
	  send out wakeup source and uevents which indicate suspend_prepare and
	  post_suspend.

config TEGRA3_PM
	bool "Tegra3 power and cluster management"
	default y
	help
	  Enable Tegra3 power and cluster management.

config TEGRA_POWERGATE
	bool "Tegra powergate support"
	default y
	help
	  Enable Tegra powergate support.

config TEGRA_BOND_OUT
	bool "Tegra bond out support"
	default n
	help
	  Enable Tegra bond out support

config TEGRA_BOOTLOADER_DEBUG
	tristate "Creates sys-fs interface dumping registers read by bootloader"
	default n
	select TEGRA_BOOTLOADER_DEBUG_INIT
	help
	  When enabled, tegra_bootloader_verify_regs sys-fs is created.

config TEGRA_BOOTLOADER_DEBUG_INIT
	bool
	depends on TEGRA_BOOTLOADER_DEBUG

config TEGRA_CBUS_CAN_USE_SKIPPERS
	bool "Allow to use clock skippers on cbus users"
	depends on ARCH_TEGRA_21x_SOC
	default n
	help
	  When enabled, clock skippers for cbus modules can be used to provide
	  fine granularity clock rate control

config TEGRA_CENTRAL_ACTMON
	bool "Tegra Activity Monitor"
	depends on ARCH_TEGRA
	default n
	help
	  Actmon is a hardware block that can be used to track the activity of
	  certain hardware units. It can boost EMC clock depending
	  on the memory trafic among various client. It is called central actmon
	  as it monitors central activity for example MC activity. HW fabric of
	  central and unit actmon is different. If unsure, say Y here.

config TEGRA_IVC
	bool "Tegra IVC protocol support"
	default n
	help
	  Enable the Tegra IVC library, which implements a lockless, shared-
	  memory queue.

config TEGRA_FIQ_DEBUGGER
	bool "Enable the FIQ serial debugger on Tegra"
	default n
	select FIQ_DEBUGGER
	select FIQ_GLUE
	help
	  Enables the FIQ serial debugger on Tegra

config TEGRA_NVDUMPER
	bool "Enable nvdumper"
	depends on ARCH_TEGRA
	default n
	help
	  This is debug feature to dump whole memory when system crashes.

config TEGRA_13x_SERROR
	tristate "Tegra13 SError handler"
	depends on ARCH_TEGRA_13x_SOC
	select DENVER_MCA
	help
	  The Tegra13 SError handler. This handles Denver SErrors.

config TEGRA_THERMAL_THROTTLE
       bool "Enable throttling of CPU speed on overtemp"
       depends on CPU_FREQ
       depends on THERMAL
       help
         Also requires enabling a temperature sensor such as NCT1008.

config TEGRA_FIRMWARES_CLASS
	bool
	default n

config TEGRA_FIRMWARES_INVENTORY
	tristate "Tegra firmwares inventory"
	select TEGRA_FIRMWARES_CLASS
	default y
	help
	  Register version readers for firmwares

config TEGRA_HV_XHCI_DEBUG
	bool "Enable Tegra Hypervisor XHCI Server Debug"
	depends on TEGRA_HV_MANAGER
	default n
	help
	  Enable Tegra XHCI Server debugging when runs in virtualization.
```
