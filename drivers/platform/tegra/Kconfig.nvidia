## drivers/platform/tegra/Kconfig.nvidia
```kconfig
config DENVER_CPU
	bool "Denver CPU"
	help
	  Support for NVIDIA Denver CPU

config DENVER_DEBUG
	bool "Denver Hardware Debug Tools"
	depends on DENVER_CPU
	help
	  This enables drivers that allow debugging the Denver CPU internals.

config DENVER_MCA
	tristate "Denver Machine Check Handler"
	depends on DENVER_CPU
	select SERROR_HANDLER
	help
	  The Denver Machine Check handler. It collects and reports errors from
	  the Denver CPUs.

config TEGRA_AON
	bool "Tegra AON driver"
	depends on ARCH_TEGRA_18x_SOC
	select TEGRA_IVC
	select TEGRA_HSP

config TEGRA_ARI_MCA
	tristate "Tegra Abstract Request Interface (ARI) Machine Check"
	select SERROR_HANDLER
	help
	  The Tegra Abstract Request Interface (ARI) Machine Check handler. This
	  handles the Machine Check registers that are accessible via ARI.

config TEGRA_BRIDGE_MCA
	tristate "AXI/APB Bridge Machine Check"
	select SERROR_HANDLER
	help
	  The Tegra AXI/APB Bridge Machine Check handler. This
	  handes the SERRs from failed AXI/APB transactions.

config TEGRA_A57_SERR
        tristate "A57 SError Handler"
	select SERROR_HANDLER
	help
	  The A57 SError Handler.  This handles the SERRs from A57 cores,
	  specifically L1 ECC errors.

config TEGRA_18X_SERROR
        tristate "Tegra18 SError handler"
        depends on ARCH_TEGRA_18x_SOC
        select DENVER_MCA
	select TEGRA_ARI_MCA
	select TEGRA_BRIDGE_MCA
	select TEGRA_A57_SERR
        help
          The Tegra18 SError handler. This handles Denver SErrors, A57 SErrors,
	  CCPLEX errors, and fabric slave errors.

config TEGRA_BWMGR
        bool "Enable EMC Bandwidth Manager"
        depends on COMMON_CLK
        default n
        help
          Enables Bandwidth manager support for EMC clock. Required when using Common Clock Framework

config TEGRA_CAMERA_RTCPU
	bool "Enable Tegra Camera RTCPU Driver"
	depends on ARCH_TEGRA_18x_SOC
	select TEGRA_IVC
	select TEGRA_HSP

config TEGRA_ISOMGR
        bool "Isochronous Bandwidth Manager "
        help
          When enabled, drivers for ISO units can obtain ISO BW.
          The memory controller (MC) for each Tegra platform can supply
          a limited amount of isochronous (real-time) bandwidth.  When
          enabled, isomgr will manage a pool of ISO BW.

config TEGRA_ISOMGR_POOL_KB_PER_SEC
        int "Size of isomgr pool "
        default 0
        help
          Set this maximum ISO BW (in Kbytes/sec) that platform supports.
          The memory controller (MC) for each Tegra platform can supply
          a limited amount of isochronous (real-time) bandwidth.  Each
          platform must specify the maximum amount of ISO BW that isomgr
          should manage.

config TEGRA_ISOMGR_SYSFS
        bool "Visibility into Isochronous Bandwidth Manager state "
        depends on TEGRA_ISOMGR
        help
          When enabled, sysfs can be used to query isomgr state.
          This is used for visibility into isomgr state.  It could
          be useful in debug or in understanding performance on a
          running system.

config TEGRA_ISOMGR_MAX_ISO_BW_QUIRK
        bool "Relax Max ISO Bw limit"
        depends on TEGRA_ISOMGR
        default n
        help
          When enabled, allows system with less ISO bw continue to
          work. This is necessary for systems running at lower
          EMC clock freq or on FPGA.

config TEGRA_MC
        bool "Tegra MC"
        default y
        help
          Enable Tegra MC.

config TEGRA_OF_MCERR
        bool "Tegra MCERR OF"
        default y
        help
          Enable Tegra MC ERR OF.

config TEGRA_PTP_NOTIFIER
	tristate "Enable PTP Notifier"
	depends on ARCH_TEGRA_18x_SOC
	default y if EQOS

config TEGRA_SAFETY_SCE
	tristate "Enable CCPLEX-SCE communication Driver for Safety"
	depends on ARCH_TEGRA_18x_SOC
	select TEGRA_IVC
	select TEGRA_HSP
	help
	  This enables communication between CCPLEX and SCE over IVC channel.
	  This also provides a userspace command response interface as
	  character device which will be used by other safety modules.
```

## drivers/soc/tegra/Kconfig
```kconfig
config TEGRA_KFUSE
	bool "Tegra kfuse support"
	default n
	depends on ARCH_TEGRA
	help
	  Enable Tegra kfuse support. The kfuse block stores downstream and
	  upstream HDCP keys for use by the HDMI module.
```

## drivers/spi/Kconfig
```kconfig
config QSPI_TEGRA186
	tristate "Nvidia Tegra18x QSPI Controller"
	depends on ARCH_TEGRA_18x_SOC && TEGRA186_GPC_DMA
	help
	  QSPI driver for Nvidia Tegra210 QSPI Controller interface. This controller
	  is different from the spi controller and first time introduces on Tegra210 soc.
```

## drivers/staging/Kconfig
```kconfig
if STAGING

source "drivers/staging/ozwpan/Kconfig"
source "drivers/staging/platform/tegra/gte/Kconfig"

endif # STAGING
```

## drivers/staging/stepper/Kconfig
```kconfig
config STEPPER_CLASS
	tristate "Stepper Class Support"
	help
	  This option enables the stepper motor control sysfs class in /sys/class/stepper.
	  The sysfs class provides useful interfaces to control stepper motor.
	  If stepper motor is not used in the platform, select N.

comment "STEPPER drivers"
```

## drivers/tachometer/Kconfig
```kconfig
menuconfig TACHOMETER
	bool "Tachometer support"
	help
	  Say Y here to Tachometer support

	  This framework provides a generic interface to Tach
	  devices.
```

## drivers/thermal/Kconfig
```kconfig
# Copyright (c) 2012-2018, NVIDIA CORPORATION.  All rights reserved.
#
# This program is free software; you can redistribute it and/or modify it
# under the terms and conditions of the GNU General Public License,
# version 2, as published by the Free Software Foundation.
#
# This program is distributed in the hope it will be useful, but WITHOUT
# ANY WARRANTY; without even the implied warranty of MERCHANTABILITY or
# FITNESS FOR A PARTICULAR PURPOSE.  See the GNU General Public License for
# more details.
#
# You should have received a copy of the GNU General Public License
# along with this program.  If not, see <http://www.gnu.org/licenses/>.

config THERMAL_GOV_PID
	bool "PID thermal governor"
	help
	  This governor manages thermals based on output values of
	  PID controller.

config TEGRA_THERMAL_THROTTLE
       bool "Enable throttling of CPU speed on overtemp"
       depends on CPU_FREQ
       depends on THERMAL
       help
         Passive cooling device that throttles clocks using cpufreq and pmqos
	 interfaces.
```

## drivers/video/tegra/Kconfig
```kconfig
if ARCH_TEGRA

config TEGRA_GR_VIRTUALIZATION
	bool "Tegra graphics virtualization support"
	default n
	depends on TEGRA_HV_MANAGER
	help
	  Adds Tegra graphics virtualization (host and gpu) support to client
	  drivers.

endif

config TEGRA_DC
	tristate "Tegra Display Contoller"
	depends on (TEGRA_GRHOST || TEGRA_HOST1X) && I2C
	select BACKLIGHT_CLASS_DEVICE
	select FB_MODE_HELPERS
	help
	 Tegra display controller support.
	 Enable this to access the Tegra display controller using either framebuffer
	 console interface and a proprietary dc-ext interface or with ADF.
```

## drivers/video/tegra/Kconfig.nvidia
```kconfig
config TEGRA_CAMERA_PLATFORM
        bool "Enable tegra camera platform driver"
        depends on ARCH_TEGRA
        depends on VIDEO_TEGRA_VI
        default y
        help
          Enables tegra camera platform driver.
          If unsure, say Y
```

## drivers/video/tegra/host/Kconfig
```kconfig
config TEGRA_GRHOST_NVDLA
	bool "Tegra NVDLA support"
	depends on TEGRA_GRHOST && ARCH_TEGRA_19x_SOC
	default y
	help
	  Enables Deep Learning Accelerator engine support under nvhost
	  Say N here if not sure.

config TEGRA_GRHOST_PVA
	bool "Tegra PVA support"
	depends on TEGRA_GRHOST && ARCH_TEGRA_19x_SOC
	default y
	help
	  Enables Programmable Vision Accelerator engine support under nvhost
	  Say Y here if not sure.
```

## drivers/virt/tegra/Kconfig
```kconfig
config TEGRA_HV_PM_CTL
	bool "Nvidia Tegra hypervisor PM control"
	depends on TEGRA_HV_MANAGER
	help
	  Nvidia Tegra hypervisor PM control driver handles power state
	  transition commands over IVC channel.
```

## drivers/watchdog/Kconfig.nvidia
```kconfig
config TEGRA18X_WATCHDOG
	tristate "Tegra T18x watchdog"
	depends on ARCH_TEGRA_18x_SOC
	help
	  Say Y here to include support for the watchdog timer
	  embedded in NVIDIA Tegra SoCs.

	  To compile this driver as a module, choose M here: the
	  module will be called tegra18x_wdt.

config TEGRA_HV_WATCHDOG
	tristate "Tegra Hypervisor watchdog"
	depends on TEGRA_HV_MANAGER
	help
	  Say Y here to include support for the watchdog timer
	  embedded in NVIDIA Tegra Hypervisor systems.

	  To compile this driver as a module, choose M here: the
	  module will be called tegra_hv_wdt.
```

## nvidia/Documentation/devicetree/bindings/tegra_hv/tegra_hv_pm_ctl.txt
```
* Tegra Hypervisor PM control (tegra_hv_pm_ctl)

Required properties:
- compatible: Should be "nvidia,tegra-hv-pm-ctl".
- ivc : IVC channel ID between Guest VM and Sysmgr.

Example:
	tegra_hv_pm_ctl {
		compatible = "nvidia,tegra-hv-pm-ctl";
		status = "okay";
		ivc = <&tegra_hv 102>;
	};
```

## nvidia/drivers/Kconfig
```kconfig
append_menu "Device Drivers"

if ARCH_TEGRA
source "drivers/misc/tegra186-ahc/Kconfig"
source "drivers/nvpmodel/Kconfig"
source "drivers/nvlink/Kconfig"
source "drivers/iommu/Kconfig"
endif

endmenu
```

## nvidia/drivers/soc/tegra/Kconfig
```kconfig
config TEGRA_KFUSE
	bool "Tegra kfuse support"
	default n
	depends on ARCH_TEGRA
	help
	  Enable Tegra kfuse support. The kfuse block stores downstream and
	  upstream HDCP keys for use by the HDMI module.

config TEGRA_PROC_POWER_MODEL
	bool "Tegra process power model support"
	depends on ARCH_TEGRA
	help
	  Used to create a simple processor power model (PPM) by
	  collating various chip specific data including voltage,
	  frequency, and number of cores. This driver is used by
	  various other drivers including EDP.

config TEGRA_ANDROID
	bool "Tegra native Android support"
	default n
	depends on ARCH_TEGRA
	help
          Use to let NVIDIA Tegra drivers run the Native Android specific
          subroutines. This Config to separate the cases of Android Container
          and native Android.
```

## nvidia/drivers/spi/Kconfig
```kconfig
if SPI
if SPI_MASTER

config SPI_TEGRA186_AON
	bool "Tegra18x AON SPI proxy driver"
	depends on ARCH_TEGRA_18x_SOC
	default y
	select NV_TEGRA_IVC
	select TEGRA_HSP

endif
endif
```

## sound/soc/tegra-alt/Kconfig
```kconfig
config SND_SOC_TEGRA_ALT
	tristate "Alternative DAPM-based SoC audio support for the Tegra System-on-Chip"
	depends on ARCH_TEGRA && TEGRA20_APB_DMA
	select REGMAP_MMIO
	select SND_SOC_DMAENGINE_PCM if TEGRA20_APB_DMA
	help
	  Say Y or M here if you want support for SoC audio on Tegra, using the
	  alternative driver that exposes to user-space the full routing capabilities
	  of the AHUB (Audio HUB) hardware module.

config SND_SOC_TEGRA_ALT_30_OR_LATER
	def_bool y
	depends on SND_SOC_TEGRA_ALT
	depends on ARCH_TEGRA_3x_SOC || ARCH_TEGRA_11x_SOC || ARCH_TEGRA_12x_SOC

config SND_SOC_TEGRA_ALT_114_OR_LATER
	def_bool y
	depends on SND_SOC_TEGRA_ALT
	depends on ARCH_TEGRA_11x_SOC || ARCH_TEGRA_12x_SOC

config SND_SOC_TEGRA30_XBAR_ALT
	tristate "Tegra30 XBAR driver"
	depends on SND_SOC_TEGRA_ALT && SND_SOC_TEGRA_ALT_30_OR_LATER
	help
	  Say Y or M if you want to add support for Tegra30 XBAR module.

config SND_SOC_TEGRA30_APBIF_ALT
	tristate "Tegra30 APBIF driver"
	depends on SND_SOC_TEGRA30_XBAR_ALT && SND_SOC_TEGRA_ALT_30_OR_LATER
	help
	  Say Y or M if you want to add support for Tegra30 APBIF module.

config SND_SOC_TEGRA30_I2S_ALT
	tristate "Tegra30 I2S driver"
	depends on SND_SOC_TEGRA_ALT && SND_SOC_TEGRA_ALT_30_OR_LATER
	help
	  Say Y or M if you want to add support for Tegra30 I2S module.

config SND_SOC_TEGRA114_AMX_ALT
	tristate "Tegra114 AMX driver"
	depends on SND_SOC_TEGRA_ALT && SND_SOC_TEGRA_ALT_114_OR_LATER
	help
	  Say Y or M if you want to add support for Tegra114 AMX module.

config SND_SOC_TEGRA114_ADX_ALT
	tristate "Tegra114 ADX driver"
	depends on SND_SOC_TEGRA_ALT && SND_SOC_TEGRA_ALT_114_OR_LATER
	help
	  Say Y or M if you want to add support for Tegra114 ADX module.
```

## sound/soc/tegra-virtual/Kconfig
```kconfig
config SND_SOC_TEGRA_VIRT_MASTER
	tristate "Virtual DAPM-based SoC audio support for the Tegra System-on-Chip"
	depends on ARCH_TEGRA
	select REGMAP_MMIO
	help
		Say Y or M here if you want support for SoC audio on Tegra, using the
		virtual driver that exposes to user-space the full routing capabilities
		of the AHUB (Audio HUB) hardware module. Audio routing is modified with
		the help of amixer utility, provided by ALSA, from user-space.

config SND_SOC_TEGRA_124_OR_LATER
  def_bool y
	depends on ARCH_TEGRA
	depends on ARCH_TEGRA_12x_SOC
	help
		Say Y or M here if the module depends upon tegra124 or later SoC.
		Virtual driver needs this as the driver support is available only
		for T124 or later SoC. For this option to work, all the dependencies
		should be selected in defconfig file.

config SND_SOC_TEGRA124_VIRT_APBIF_SLAVE
	tristate "Tegra124 APBIF slave"
	depends on SND_SOC_TEGRA_124_OR_LATER
	depends on MACH_P1859
	help
		Say Y or M if you want to add support for Tegra124 APBIF slave module.
		APBIF_SLAVE module exposes only apbif dai links to apbdma. This module
		can be build independent of APBIF_MASTER module. This module provides
		a pcm interface to slave card in audio virtualization use case.

config SND_SOC_TEGRA_VIRT_VCM30T124_MASTER
	tristate "SoC Audio master for VCM30_T124"
	depends on SND_SOC_TEGRA_VIRT_MASTER
	depends on MACH_P1859
	select SND_SOC_TEGRA_VCM30T124_ALT
	help
		Say Y or M here if you want to add master support for SoC audio on the
		TEGRA VCM30_T124 using wm8731 and ad1937 codecs. This Kconfig automatically
		selects dependancies. All the AHUB codec drivers are selected from tegra-alt
		driver. Only APBIF driver is different.

config SND_SOC_TEGRA_VIRT_VCM30T124_SLAVE
	tristate "SoC Audio Slave for VCM30_T124"
	depends on TEGRA20_APB_DMA
	depends on MACH_P1859
	select SND_SOC_TEGRA_ALT
	select SND_SOC_TEGRA124_VIRT_APBIF_SLAVE
	select SND_SOC_SPDIF
	help
		Say Y or M here if you want to add slave interface for SoC audio on the
		TEGRA. This option automatically selects all the required dependancies.
		pcm driver is selected from tegra-alt. Selecting APBIF_SLAVE option
		enables apbif dai link interface.
```
