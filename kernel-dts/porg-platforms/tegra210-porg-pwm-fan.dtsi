/*
 * Copyright (c) 2018, NVIDIA CORPORATION.  All rights reserved.
 *
 * This program is free software; you can redistribute it and/or modify it
 * under the terms and conditions of the GNU General Public License,
 * version 2, as published by the Free Software Foundation.
 *
 * This program is distributed in the hope it will be useful, but WITHOUT
 * ANY WARRANTY; without even the implied warranty of MERCHANTABILITY or
 * FITNESS FOR A PARTICULAR PURPOSE.  See the GNU General Public License for
 * more details.
 */
#include <dt-bindings/pwm/pwm.h>

/ {
	pwm_fan_shared_data: pfsd {
		num_resources = <0>;
		secret = <47>;
		active_steps = <10>;
		active_rpm = <0 1000 2000 3000 4000 5000 6000 7000 10000 11000>;
		active_rru = <10240 512 256 256 256 256 256 256 256 256>;
		active_rrd = <10240 512 256 256 256 256 256 256 256 256>;
		state_cap_lookup = <2 2 2 2 3 3 3 4 4 4>;
		pwm_period = <65536>;
		pwm_id = <3>;
		step_time = <100>; /* mesecs */
		state_cap = <7>;
		active_pwm_max = <65536>;
		tach_gpio =  <&gpio TEGRA_GPIO(Z, 2) GPIO_ACTIVE_LOW>; /* TEGRA_GPIO_PZ2 */
		pwm_gpio = <&gpio TEGRA_GPIO(E, 7) GPIO_ACTIVE_LOW>; /* TEGRA_GPIO_PE7 */
		pwm_polarity = <PWM_POLARITY_NORMAL>;
		tach_period = <1000>;
	};

	pwm-fan {
		compatible = "pwm-fan";
		status = "okay";
		pwms = <&tegra_pwm 3 65536>;
		shared_data = <&pwm_fan_shared_data>;
		active_pwm = <0 16640 28160 40960 51200 61440 62720 64000 64512 65535>;
	};
};
