/*
 * Copyright (c) 2018, NVIDIA CORPORATION.  All rights reserved.
 *
 * This program is free software; you can redistribute it and/or modify it
 * under the terms and conditions of the GNU General Public License,
 * version 2, as published by the Free Software Foundation.
 *
 * This program is distributed in the hope it will be useful, but WITHOUT
 * ANY WARRANTY; without even the implied warranty of MERCHANTABILITY or
 * FITNESS FOR A PARTICULAR PURPOSE.  See the GNU General Public License for
 * more details.
 */

/ {
	thermal_fan_est_shared_data: tfesd {
		secret = <37>;
		toffset = <0>;
		polling_period = <1100>;
		ndevs = <1>;
		cdev_type = "pwm-fan";
		tzp_governor_name = "pid_thermal_gov";

		dev1 {
			dev_data = "CPU-therm";
			coeffs = <100 0 0 0 0 0 0 0 0 0 0 0 0 0 0 0 0 0 0 0>;
		};
	};

	thermal-fan-est {
		name = "thermal-fan-est";
		compatible = "thermal-fan-est";
		status = "okay";
		num_resources = <0>;
		shared_data = <&thermal_fan_est_shared_data>;
		trip_length = <10>;
		active_trip_temps = <0 63000 65000 79000 135000
				140000 150000 160000 170000 180000>;
		active_hysteresis = <0 30000 1000 10000 0
				0 0 0 0 0>;
	};
};
