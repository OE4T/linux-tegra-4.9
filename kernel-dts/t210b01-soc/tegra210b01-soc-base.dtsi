/*
 * tegra210b01-soc-base.dtsi: SOC specific DTSI file with all node disabled.
 *
 * Copyright (c) 2017, NVIDIA CORPORATION.  All rights reserved.
 *
 * This program is free software; you can redistribute it and/or modify
 * it under the terms of the GNU General Public License as published by
 * the Free Software Foundation; version 2 of the License.
 *
 * This program is distributed in the hope that it will be useful, but WITHOUT
 * ANY WARRANTY; without even the implied warranty of MERCHANTABILITY or
 * FITNESS FOR A PARTICULAR PURPOSE.  See the GNU General Public License for
 * more details.
 */
#include <tegra210-soc/tegra210-soc-base.dtsi>

/ {
	compatible = "nvidia,tegra210b01", "nvidia,tegra210";

	se_elp: se_elp@70420000 {
		compatible = "nvidia,tegra210b01-se-elp";
		reg = <0x0 0x70420000 0x0 0x10000>;
		interrupts = <0 191 0x04>;
		clocks = <&tegra_car TEGRA210_CLK_SE_CBUS>;
		clock-names = "se";
		pka1-rsa-priority = <300>;
		status = "disabled";
	};

	efuse@7000f800 {
		efuse-burn {
			compatible = "nvidia,tegra210b01-efuse-burn";
		};
	};
};
