/*
 * tegra194-soc-actmon.dtsi: Tegra194 soc dtsi file for central actmon instances
 *
 * Copyright (c) 2017, NVIDIA CORPORATION.  All rights reserved.
 *
 * This program is free software; you can redistribute it and/or modify
 * it under the terms of the GNU General Public License as published by
 * the Free Software Foundation; version 2 of the License.
 *
 * This program is distributed in the hope that it will be useful, but WITHOUT
 * ANY WARRANTY; without even the implied warranty of MERCHANTABILITY or
 * FITNESS FOR A PARTICULAR PURPOSE.  See the GNU General Public License for
 * more details.
 */

/ {
	actmon@d230000 {
		status = "disabled";
		#address-cells = <2>;
		#size-cells = <2>;
		/* tegra194 central actmon */
		compatible = "nvidia,tegra194-cactmon";
		reg = <0x0 0x0d230000 0x0 0x1000>; /* ACTMON_BASE */
		interrupts = <0 TEGRA194_IRQ_ACTMON IRQ_TYPE_LEVEL_HIGH>;
		clocks = <&bpmp_clks TEGRA194_CLK_ACTMON>;
		clock-names = "actmon";
		#stream-id-cells = <1>;
		resets = <&bpmp_resets TEGRA194_RESET_ACTMON>;
		reset-names = "actmon_rst";
		nvidia,sample_period = /bits/ 8 <20>;

		mc_all {	/* MC_ALL actmon device */
			#address-cells = <1>;
			#size-cells = <0>;
			nvidia,reg_offs = <0x100>;
			nvidia,irq_mask = <0x2>;
			/* EMC_PLLP_FREQ + 2000 */
			nvidia,suspend_freq = <204000>;
			nvidia,boost_freq_step = <204000>;
			nvidia,boost_up_coef = <200>;
			nvidia,boost_down_coef = <50>;
			nvidia,boost_up_threshold = <30>;
			nvidia,boost_down_threshold = <20>;
			nvidia,up_wmark_window = /bits/ 8 <3>;
			nvidia,down_wmark_window = /bits/ 8 <2>;
			nvidia,avg_window_log2 = /bits/ 8 <6>;
			/* Activity counter is increamented every 256 memory
			 * transactions. Considering 64 bytes Bus and each
			 * emc clock(DRAM clock) reads 16 Bytes, It will need
			 * 64/16 = 4 emc clocks to read 64 Bytes wider memory
			 * bus. Hence count_weight, W = 4 * 256 = 0x400.
			 */
			nvidia,count_weight = <0x400>;
			nvidia,type = <1>;
			status = "disabled";
		};
       };
};
