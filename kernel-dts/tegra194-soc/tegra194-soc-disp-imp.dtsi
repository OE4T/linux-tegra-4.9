/*
 * Copyright (c) 2017, NVIDIA CORPORATION.  All rights reserved.
 *
 * This program is free software; you can redistribute it and/or modify
 * it under the terms of the GNU General Public License as published by
 * the Free Software Foundation; either version 2 of the License, or
 * (at your option) any later version.
 *
 * This program is distributed in the hope that it will be useful, but WITHOUT
 * ANY WARRANTY; without even the implied warranty of MERCHANTABILITY or
 * FITNESS FOR A PARTICULAR PURPOSE.  See the GNU General Public License for
 * more details.
 *
 * You should have received a copy of the GNU General Public License along
 * with this program; if not, write to the Free Software Foundation, Inc.,
 * 51 Franklin Street, Fifth Floor, Boston, MA  02110-1301, USA.
 */

/ {
	host1x {
		disp_imp_table: disp_imp_table {
			status = "okay";
			num_settings = <1>;

			/* This is just an initial placeholder. */
			disp_imp_settings_0 {
				/* Global settings */
				nvidia,total_disp_bw_with_catchup = <0 0>;
				nvidia,total_disp_bw_without_catchup = <0 0>;
				nvidia,disp_emc_floor = <0 0>;
				nvidia,disp_min_hubclk = <0 0>;
				nvidia,total_win_fetch_slots = /bits/ 16 <0>;
				nvidia,total_cursor_fetch_slots = /bits/ 16 <0>;

				/* Window settings */
				nvidia,imp_win_mapping = /bits/ 8 <0 1 2 3 4 5>;
				nvidia,win_fetch_meter_slots = /bits/ 16 <0 0 0 0 0 0>;
				nvidia,win_dvfs_watermark_values = <0 0 0 0 0 0 0 0 0 0 0 0>;
				nvidia,win_pipe_meter_values = <0 0 0 0 0 0>;
				nvidia,win_mempool_buffer_entries = <0 0 0 0 0 0 0 0 0 0 0 0>;
				nvidia,win_thread_groups = /bits/ 8 <(-1) (-1) (-1) (-1) (-1) (-1)>;

				/* Cursor settings */
				nvidia,imp_head_mapping = /bits/ 8 <0 1 2 3>;
				nvidia,cursor_fetch_meter_slots = /bits/ 16 <0 0 0>;
				nvidia,cursor_dvfs_watermark_values = <0 0 0 0 0 0>;
				nvidia,cursor_pipe_meter_values = <0 0 0>;
				nvidia,cursor_mempool_buffer_entries = <0 0 0 0 0 0>;
			};
		};
	};
};
