/*
 * Copyright (c) 2016, NVIDIA CORPORATION.  All rights reserved.
 *
 * This program is free software; you can redistribute it and/or modify it
 * under the terms and conditions of the GNU General Public License,
 * version 2, as published by the Free Software Foundation.
 *
 * This program is distributed in the hope it will be useful, but WITHOUT
 * ANY WARRANTY; without even the implied warranty of MERCHANTABILITY or
 * FITNESS FOR A PARTICULAR PURPOSE.  See the GNU General Public License for
 * more details.
 *
 * You should have received a copy of the GNU General Public License
 * along with this program.  If not, see <http://www.gnu.org/licenses/>.
 */

#include <dt-bindings/clock/tegra194-clock.h>
#include <dt-bindings/reset/tegra194-reset.h>

/ {

	aliases {
		sdhci3 = &sdmmc4;
		sdhci2 = &sdmmc3;
	};

	sdmmc4: sdhci@3460000 { /* Used for eMMC */
		compatible = "nvidia,tegra194-sdhci";
		reg = <0x0 0x3460000 0x0 0x00020000>;
		interrupts = < 0 65 0x04>;
		max-clk-limit = <196249804>;
		ddr-clk-limit = <48000000>;
		tap-delay = <9>;
		trim-delay = <5>;
		nvidia,ddr-tap-delay = <9>;
		ddr-trim-delay = <5>;
		dqs-trim-delay = <63>;
		dqs-trim-delay-hs533 = <40>;
		bus-width = <8>;
		ignore-pm-notify;
		keep-power-in-suspend;
		non-removable;
		cap-mmc-highspeed;
		cap-sd-highspeed;
		mmc-ddr-1_8v;
		mmc-hs200-1_8v;
		mmc-hs400-1_8v;
		mmc-hs400-enhanced-strobe;
		compad-vref-3v3 = <0x7>;
		compad-vref-1v8 = <0x7>;
		uhs-mask = <0x60>;
		nvidia,is-emmc;
		calib-3v3-offsets = <0x0505>;
		calib-1v8-offsets = <0x0505>;
		resets = <&bpmp_resets TEGRA194_RESET_SDMMC4>;
		reset-names = "sdmmc";
		pll_source = "pll_p";
		clocks = <&bpmp_clks TEGRA194_CLK_SDMMC4>,
			<&bpmp_clks TEGRA194_CLK_PLLP_OUT0>,
			<&bpmp_clks TEGRA194_CLK_SDMMC_LEGACY_TM>;
		clock-names = "sdmmc", "pll_p", "sdmmc_legacy_tm";
		status = "disabled";
	};

	sdmmc3: sdhci@3440000 {
		compatible = "nvidia,tegra194-sdhci";
		reg = <0x0 0x3440000 0x0 0x00020000>;
		interrupts = < 0 64 0x04>;
		max-clk-limit = <64000000>;
		tap-delay = <11>;
		trim-delay = <5>;
		mmc-ocr-mask = <3>;
		bus-width = <4>;
		cap-mmc-highspeed;
		cap-sd-highspeed;
		uhs-mask = <0x1C>;
		pll_source = "pll_p";
		resets = <&bpmp_resets TEGRA194_RESET_SDMMC3>;
		reset-names = "sdmmc";
		clocks = <&bpmp_clks TEGRA194_CLK_SDMMC3>,
		       <&bpmp_clks TEGRA194_CLK_PLLP_OUT0>;
		clock-names = "sdmmc", "pll_p";
		status = "disabled";
	 };
};
