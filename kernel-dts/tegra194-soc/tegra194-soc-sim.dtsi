/*
 * tegra194-soc-sim.dtsi: Simulation and Emulation SOC base
 *			  DTSI file used for all sim DTSI.
 *
 * Copyright (c) 2017, NVIDIA CORPORATION.  All rights reserved.
 *
 * This program is free software; you can redistribute it and/or modify
 * it under the terms of the GNU General Public License as published by
 * the Free Software Foundation; version 2 of the License.
 *
 * This program is distributed in the hope that it will be useful, but WITHOUT
 * ANY WARRANTY; without even the implied warranty of MERCHANTABILITY or
 * FITNESS FOR A PARTICULAR PURPOSE.  See the GNU General Public License for
 * more details.
 */

#include <tegra194-soc/tegra194-soc-base.dtsi>

/ {
	cpus {
		/*
		 * Override the MPIDR value for simulator because MPIDR
		 * value returned by the CPU on simulator is different
		 * from the one in soc-base dtsi.
		 */
		cpu@0 {
			reg = <0x0 0x0>;
		};
	};
};
