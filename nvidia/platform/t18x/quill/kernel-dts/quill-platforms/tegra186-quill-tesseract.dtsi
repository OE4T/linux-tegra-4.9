/*
 * tegra186-quill-tesseract.dtsi: SCE running Tesseract FW on Quill.
 *
 * Copyright (c) 2017, NVIDIA CORPORATION.  All rights reserved.
 *
 * This program is free software; you can redistribute it and/or modify
 * it under the terms of the GNU General Public License as published by
 * the Free Software Foundation; version 2 of the License.
 *
 * This program is distributed in the hope that it will be useful, but WITHOUT
 * ANY WARRANTY; without even the implied warranty of MERCHANTABILITY or
 * FITNESS FOR A PARTICULAR PURPOSE.  See the GNU General Public License for
 * more details.
 */

#include "quill-platforms/tegra186-quill-camera-ape.dtsi"

/ {
	tegra-hsp@b150000 {
		status = "okay";
	};

	tesseract@b000000 { /* Use SCE as tesseract-rtcpu */
		status = "okay";
		nvidia,cmd-timeout = <10000>;
	};
};
