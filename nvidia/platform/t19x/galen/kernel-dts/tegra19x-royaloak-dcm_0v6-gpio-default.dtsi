/*This dtsi file was generated by dcm_0v6.xlsm Revision: 1.06 */
/*
 * Copyright (c) 2017, NVIDIA CORPORATION.  All rights reserved.
 *
 * This program is free software; you can redistribute it and/or modify
 * it under the terms of the GNU General Public License as published by
 * the Free Software Foundation; either version 2 of the License, or
 * (at your option) any later version.
 *
 * This program is distributed in the hope that it will be useful, but WITHOUT
 * ANY WARRANTY; without even the implied warranty of MERCHANTABILITY or
 * FITNESS FOR A PARTICULAR PURPOSE.  See the GNU General Public License for
 * more details.
 */

#include <dt-bindings/gpio/tegra-gpio.h>

/ {
	gpio@2200000 {
		gpio-init-names = "default";
		gpio-init-0 = <&gpio_default>;

		gpio_default: default {
			gpio-input = <
				TEGRA_GPIO(S, 5)
				TEGRA_GPIO(S, 6)
				TEGRA_GPIO(S, 7)
				TEGRA_GPIO(G, 0)
				TEGRA_GPIO(G, 1)
				TEGRA_GPIO(G, 4)
				TEGRA_GPIO(H, 2)
				TEGRA_GPIO(Z, 2)
				TEGRA_GPIO(EE, 4)
				TEGRA_GPIO(AA, 7)
				TEGRA_GPIO(BB, 2)
				TEGRA_GPIO(P, 4)
				TEGRA_GPIO(P, 5)
				TEGRA_GPIO(P, 6)
				TEGRA_GPIO(Q, 0)
				TEGRA_GPIO(Q, 1)
				TEGRA_GPIO(Q, 4)
				TEGRA_GPIO(N, 0)
				>;
			gpio-output-low = <
				TEGRA_GPIO(G, 5)
				TEGRA_GPIO(X, 0)
				TEGRA_GPIO(X, 1)
				TEGRA_GPIO(B, 0)
				TEGRA_GPIO(B, 1)
				TEGRA_GPIO(M, 3)
				TEGRA_GPIO(M, 6)
				>;
			gpio-output-high = <
				TEGRA_GPIO(AA, 4)
				>;
		};
	};
};
